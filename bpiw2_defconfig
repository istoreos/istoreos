## bpiw2_defconfig
```kconfig
CONFIG_TARGET_realtek=y
CONFIG_TARGET_realtek_rtd129x=y
CONFIG_TARGET_realtek_rtd129x_DEVICE_bpi-w2=y
CONFIG_DEVEL=y
CONFIG_ARIA2_BITTORRENT=y
CONFIG_ARIA2_NOXML=y
CONFIG_ARIA2_OPENSSL=y
CONFIG_ARIA2_WEBSOCKET=y
CONFIG_CCACHE=y
CONFIG_EXTERNAL_KERNEL_TREE="/Volumes/sd/src/bpiw2/build-4.4"
CONFIG_GNUTLS_ALPN=y
CONFIG_GNUTLS_ANON=y
CONFIG_GNUTLS_DTLS_SRTP=y
CONFIG_GNUTLS_HEARTBEAT=y
CONFIG_GNUTLS_OCSP=y
CONFIG_GNUTLS_PSK=y
CONFIG_KERNEL_NF_CONNTRACK=y
CONFIG_KERNEL_RTL_BR_SHORTCUT=y
CONFIG_KERNEL_RTL_JUMBO_FRAME=y
CONFIG_KERNEL_RTL_TSO=y
CONFIG_NFS_KERNEL_SERVER_V4=y
CONFIG_PACKAGE_adblock=y
CONFIG_PACKAGE_aria2=y
CONFIG_PACKAGE_attr=y
CONFIG_PACKAGE_avahi-dbus-daemon=y
CONFIG_PACKAGE_bash=y
CONFIG_PACKAGE_blkid=y
CONFIG_PACKAGE_boost=y
CONFIG_PACKAGE_boost-chrono=y
CONFIG_PACKAGE_boost-random=y
CONFIG_PACKAGE_boost-system=y
CONFIG_PACKAGE_btrfs-progs=y
CONFIG_PACKAGE_coreutils=y
CONFIG_PACKAGE_coreutils-sort=y
CONFIG_PACKAGE_dbus=y
CONFIG_PACKAGE_icu=y
CONFIG_PACKAGE_ip-full=y
CONFIG_PACKAGE_iptables-mod-conntrack-extra=y
CONFIG_PACKAGE_iptables-mod-ipopt=y
CONFIG_PACKAGE_iw=y
CONFIG_PACKAGE_kmod-ata-ahci=y
CONFIG_PACKAGE_kmod-ata-core=y
CONFIG_PACKAGE_kmod-bonding=y
CONFIG_PACKAGE_kmod-crypto-cbc=y
CONFIG_PACKAGE_kmod-crypto-ccm=y
CONFIG_PACKAGE_kmod-crypto-cmac=y
CONFIG_PACKAGE_kmod-crypto-crc32c=y
CONFIG_PACKAGE_kmod-crypto-ctr=y
CONFIG_PACKAGE_kmod-crypto-cts=y
CONFIG_PACKAGE_kmod-crypto-des=y
CONFIG_PACKAGE_kmod-crypto-gcm=y
CONFIG_PACKAGE_kmod-crypto-gf128=y
CONFIG_PACKAGE_kmod-crypto-ghash=y
CONFIG_PACKAGE_kmod-crypto-hmac=y
CONFIG_PACKAGE_kmod-crypto-iv=y
CONFIG_PACKAGE_kmod-crypto-md4=y
CONFIG_PACKAGE_kmod-crypto-md5=y
CONFIG_PACKAGE_kmod-crypto-rng=y
CONFIG_PACKAGE_kmod-crypto-seqiv=y
CONFIG_PACKAGE_kmod-crypto-sha256=y
CONFIG_PACKAGE_kmod-crypto-sha512=y
CONFIG_PACKAGE_kmod-crypto-wq=y
CONFIG_PACKAGE_kmod-dax=y
CONFIG_PACKAGE_kmod-dm=y
CONFIG_PACKAGE_kmod-dnsresolver=y
CONFIG_PACKAGE_kmod-fs-cifs=y
CONFIG_PACKAGE_kmod-fs-exfat=y
CONFIG_PACKAGE_kmod-fs-exportfs=y
CONFIG_PACKAGE_kmod-fs-ext4=y
CONFIG_PACKAGE_kmod-fs-isofs=y
CONFIG_PACKAGE_kmod-fs-msdos=y
CONFIG_PACKAGE_kmod-fs-nfs=y
CONFIG_PACKAGE_kmod-fs-nfs-common=y
CONFIG_PACKAGE_kmod-fs-nfs-common-rpcsec=y
CONFIG_PACKAGE_kmod-fs-nfs-v3=y
CONFIG_PACKAGE_kmod-fs-nfs-v4=y
CONFIG_PACKAGE_kmod-fs-nfsd=y
CONFIG_PACKAGE_kmod-fs-squashfs=y
CONFIG_PACKAGE_kmod-fs-vfat=y
CONFIG_PACKAGE_kmod-fuse=y
CONFIG_PACKAGE_kmod-gre=y
CONFIG_PACKAGE_kmod-gre6=y
CONFIG_PACKAGE_kmod-ifb=y
CONFIG_PACKAGE_kmod-ip6-tunnel=y
CONFIG_PACKAGE_kmod-ipt-conntrack-extra=y
CONFIG_PACKAGE_kmod-ipt-iface=y
CONFIG_PACKAGE_kmod-ipt-ipopt=y
CONFIG_PACKAGE_kmod-ipt-iprange=y
CONFIG_PACKAGE_kmod-ipt-nat6=y
CONFIG_PACKAGE_kmod-ipt-offload=y
CONFIG_PACKAGE_kmod-ipt-raw=y
CONFIG_PACKAGE_kmod-ipt-tproxy=y
CONFIG_PACKAGE_kmod-iptunnel=y
CONFIG_PACKAGE_kmod-iptunnel6=y
CONFIG_PACKAGE_kmod-leds-gpio=y
CONFIG_PACKAGE_kmod-ledtrig-default-on=y
CONFIG_PACKAGE_kmod-ledtrig-gpio=y
CONFIG_PACKAGE_kmod-ledtrig-heartbeat=y
CONFIG_PACKAGE_kmod-ledtrig-netdev=y
CONFIG_PACKAGE_kmod-ledtrig-timer=y
CONFIG_PACKAGE_kmod-lib-crc16=y
CONFIG_PACKAGE_kmod-lib-zlib-inflate=y
CONFIG_PACKAGE_kmod-loop=y
CONFIG_PACKAGE_kmod-mii=y
CONFIG_PACKAGE_kmod-mmc=y
CONFIG_PACKAGE_kmod-nat46=y
CONFIG_PACKAGE_kmod-nf-flow=y
CONFIG_PACKAGE_kmod-nf-nat6=y
CONFIG_PACKAGE_kmod-nls-base=y
CONFIG_PACKAGE_kmod-nls-cp437=y
CONFIG_PACKAGE_kmod-nls-iso8859-1=y
CONFIG_PACKAGE_kmod-nls-utf8=y
CONFIG_PACKAGE_kmod-rtd1295hwnat=y
CONFIG_PACKAGE_kmod-rtk-emmc=y
CONFIG_PACKAGE_kmod-rtk-spi=y
# CONFIG_PACKAGE_kmod-rtl8169soc is not set
CONFIG_PACKAGE_kmod-sched-connmark=y
CONFIG_PACKAGE_kmod-sched-core=y
CONFIG_PACKAGE_kmod-scsi-core=y
CONFIG_PACKAGE_kmod-sdhci=y
CONFIG_PACKAGE_kmod-tun=y
CONFIG_PACKAGE_kmod-usb-core=y
CONFIG_PACKAGE_kmod-usb-dwc3=y
CONFIG_PACKAGE_kmod-usb-ledtrig-usbport=y
CONFIG_PACKAGE_kmod-usb-ohci=y
CONFIG_PACKAGE_kmod-usb-storage=y
CONFIG_PACKAGE_kmod-usb3=y
CONFIG_PACKAGE_kmod-veth=y
CONFIG_PACKAGE_libatomic=y
CONFIG_PACKAGE_libattr=y
CONFIG_PACKAGE_libavahi-client=y
CONFIG_PACKAGE_libavahi-dbus-support=y
CONFIG_PACKAGE_libbz2=y
CONFIG_PACKAGE_libcap=y
CONFIG_PACKAGE_libcap-ng=y
CONFIG_PACKAGE_libdaemon=y
CONFIG_PACKAGE_libdbus=y
CONFIG_PACKAGE_libdevmapper=y
CONFIG_PACKAGE_libdouble-conversion=y
CONFIG_PACKAGE_libelf=y
CONFIG_PACKAGE_libevent2=y
CONFIG_PACKAGE_libexif=y
CONFIG_PACKAGE_libexpat=y
CONFIG_PACKAGE_libffmpeg-audio-dec=y
CONFIG_PACKAGE_libflac=y
CONFIG_PACKAGE_libgnutls=y
CONFIG_PACKAGE_libid3tag=y
CONFIG_PACKAGE_libjpeg=y
CONFIG_PACKAGE_libkeyutils=y
CONFIG_PACKAGE_liblzo=y
CONFIG_PACKAGE_libminiupnpc=y
CONFIG_PACKAGE_libmount=y
CONFIG_PACKAGE_libnatpmp=y
CONFIG_PACKAGE_libncurses=y
CONFIG_PACKAGE_libnl-core=y
CONFIG_PACKAGE_libnl-genl=y
CONFIG_PACKAGE_libogg=y
CONFIG_PACKAGE_libpcre2-16=y
CONFIG_PACKAGE_libpopt=y
CONFIG_PACKAGE_libreadline=y
CONFIG_PACKAGE_libsqlite3=y
CONFIG_PACKAGE_libstdcpp=y
CONFIG_PACKAGE_libtasn1=y
CONFIG_PACKAGE_libtirpc=y
CONFIG_PACKAGE_libustream-openssl=y
CONFIG_PACKAGE_libuv=y
CONFIG_PACKAGE_libvorbis=y
CONFIG_PACKAGE_libwebsockets-full=y
CONFIG_PACKAGE_libwrap=y
CONFIG_PACKAGE_libzstd=y
CONFIG_PACKAGE_lsblk=y
CONFIG_PACKAGE_luci-app-adblock=y
CONFIG_PACKAGE_luci-app-aria2=y
CONFIG_PACKAGE_luci-app-diskman=y
CONFIG_PACKAGE_luci-app-fileassistant=y
CONFIG_PACKAGE_luci-app-filebrowser=y
CONFIG_PACKAGE_luci-app-minidlna=y
CONFIG_PACKAGE_luci-app-qos=y
CONFIG_PACKAGE_luci-app-samba4=y
CONFIG_PACKAGE_luci-app-transmission=y
CONFIG_PACKAGE_luci-app-ttyd=y
CONFIG_PACKAGE_luci-app-upnp=y
CONFIG_PACKAGE_luci-i18n-adblock-zh-cn=y
CONFIG_PACKAGE_luci-i18n-aria2-zh-cn=y
CONFIG_PACKAGE_luci-i18n-filebrowser-zh-cn=y
CONFIG_PACKAGE_luci-i18n-minidlna-zh-cn=y
CONFIG_PACKAGE_luci-i18n-qos-zh-cn=y
CONFIG_PACKAGE_luci-i18n-samba4-zh-cn=y
CONFIG_PACKAGE_luci-i18n-transmission-zh-cn=y
CONFIG_PACKAGE_luci-i18n-ttyd-zh-cn=y
CONFIG_PACKAGE_luci-i18n-upnp-zh-cn=y
CONFIG_PACKAGE_luci-proto-relay=y
CONFIG_PACKAGE_luci-theme-argon-dark-mod=m
CONFIG_PACKAGE_luci-theme-argon-light-mod=m
CONFIG_PACKAGE_luci-theme-material=y
CONFIG_PACKAGE_minidlna=y
CONFIG_PACKAGE_miniupnpd=y
CONFIG_PACKAGE_nfs-kernel-server=y
CONFIG_PACKAGE_nfs-kernel-server-utils=y
CONFIG_PACKAGE_nfs-utils-libs=y
CONFIG_PACKAGE_parted=y
CONFIG_PACKAGE_qBittorrent=y
CONFIG_PACKAGE_qos-scripts=y
CONFIG_PACKAGE_qt5-core=y
CONFIG_PACKAGE_qt5-network=y
CONFIG_PACKAGE_qt5-xml=y
CONFIG_PACKAGE_rblibtorrent=y
CONFIG_PACKAGE_relayd=y
CONFIG_PACKAGE_rpcbind=y
CONFIG_PACKAGE_samba4-admin=y
CONFIG_PACKAGE_samba4-libs=y
CONFIG_PACKAGE_samba4-server=y
CONFIG_PACKAGE_samba4-utils=y
CONFIG_PACKAGE_smartmontools=y
CONFIG_PACKAGE_tc=y
CONFIG_PACKAGE_terminfo=y
CONFIG_PACKAGE_transmission-daemon-openssl=y
CONFIG_PACKAGE_transmission-web-control=y
CONFIG_PACKAGE_ttyd=y
CONFIG_PACKAGE_uclibcxx=y
CONFIG_PACKAGE_wireless-regdb=y
CONFIG_PACKAGE_wsdd2=y
CONFIG_RPCBIND_LIBWRAP=y
CONFIG_RPCBIND_RMTCALLS=y
CONFIG_SAMBA4_SERVER_AVAHI=y
CONFIG_SAMBA4_SERVER_NETBIOS=y
CONFIG_SAMBA4_SERVER_VFS=y
CONFIG_SQLITE3_DYNAMIC_EXTENSIONS=y
CONFIG_SQLITE3_FTS3=y
CONFIG_SQLITE3_FTS4=y
CONFIG_SQLITE3_FTS5=y
CONFIG_SQLITE3_JSON1=y
CONFIG_SQLITE3_RTREE=y
# CONFIG_TARGET_ROOTFS_INITRAMFS is not set
CONFIG_ZSTD_OPTIMIZE_O3=y
CONFIG_boost-compile-visibility-hidden=y
CONFIG_boost-runtime-shared=y
CONFIG_boost-static-and-shared-libs=y
CONFIG_boost-variant-release=y
# CONFIG_KERNEL_RTL_IVL_SUPPORT is not set
# CONFIG_KERNEL_RTL_VLAN_8021Q is not set
# CONFIG_KERNEL_VLAN_8021Q is not set
```

## package/boot/uboot-realtek/src/board/realtek/Kconfig
```kconfig
menu "RealTek Board Type"
	depends on TARGET_RTD1295 || TARGET_RTD1395

choice
	prompt "Board Type Select"

config BOARD_FPGA
	bool "FPGA Board"

config BOARD_QA
	bool "QA Board"

endchoice
endmenu

config NAS_ENABLE
	bool "NAS version Feature"

if TARGET_RTD1295

config SYS_VENDOR
	default "realtek"

config SYS_SOC
	default "rtd1295"

config SYS_BOARD
	default "1295_fpga" if BOARD_FPGA
	default "1295_qa" if BOARD_QA

config SYS_CONFIG_NAME
	string "Definition of flash type"
	default "rtd1295_fpga" if BOARD_FPGA
	default "rtd1295_qa_emmc_64" if BOARD_QA


endif #TARGET_RTD1295

if TARGET_RTD1395

config SYS_VENDOR
	default "realtek"

config SYS_SOC
	default "rtd1395"

config SYS_BOARD
	default "1395_fpga" if BOARD_FPGA
	default "1395_qa" if BOARD_QA

config SYS_CONFIG_NAME
	default "rtd1395_fpga" if BOARD_FPGA
	default "rtd1395_qa_emmc" if BOARD_QA


endif #TARGET_RTD1395
```

## package/boot/uboot-realtek/src/configs/rtd1295_fpga_defconfig
```kconfig
CONFIG_ARM=y
CONFIG_TARGET_RTD1295=y
CONFIG_BOARD_FPGA=y
CONFIG_SYS_MALLOC_CLEAR_ON_INIT=y
CONFIG_RTK_XEN_MONITOR_SUPPORT=y

#
# Enabled commands
#
CONFIG_CMD_UNZIP=y
CONFIG_CMD_SOURCE=y
CONFIG_CMD_GETTIME=y
CONFIG_CMD_GICTEST=y
CONFIG_CMD_CACHETEST=y
CONFIG_CMD_BOOTR=y
CONFIG_CMD_BOOTM=y

#
# Disabled commands
#

# CONFIG_CMD_NET is not set
# CONFIG_CMD_NFS is not set
# CONFIG_CMD_IMLS is not set
# CONFIG_CMD_FPGA is not set
# CONFIG_CMD_BOOTD is not set
# CONFIG_CMD_CRC32 is not set
# CONFIG_CMD_ECHO is not set
# CONFIG_CMD_ITEST is not set
# CONFIG_CMD_XIMG is not set
# CONFIG_CMD_MISC is not set
# CONFIG_CMD_SETGETDCR is not set
# CONFIG_CMD_IMI is not set
# CONFIG_CMD_IMPORTENV is not set
# CONFIG_CMD_EXPORTENV is not set
# CONFIG_CMD_RUN is not set
# CONFIG_CMD_BASE is not set
# CONFIG_CMD_LOOP is not set
# CONFIG_CMD_TEST is not set
# CONFIG_CMD_TRUE is not set
# CONFIG_CMD_FALSE is not set
# CONFIG_CMD_LOADS is not set
# CONFIG_CMD_LOADB is not set
# CONFIG_CMD_EXIT is not set
# CONFIG_CMD_CONSOLE is not set
# CONFIG_CMD_SHOWVAR is not set
# CONFIG_CMD_MM is not set
# CONFIG_CMD_NM is not set
# CONFIG_CMD_CMP is not set
# CONFIG_CMD_CP is not set
```

## package/boot/uboot-realtek/src/configs/rtd1296_emmc_bananapi_defconfig
```kconfig
CONFIG_ARM=y
CONFIG_TARGET_RTD1296=y
CONFIG_TARGET_RTD1295=y
CONFIG_BOARD_QA=y
CONFIG_SYS_MALLOC_CLEAR_ON_INIT=y
CONFIG_RTK_XEN_MONITOR_SUPPORT=y
CONFIG_RTK_SLAVE_CPU_BOOT=y
CONFIG_RTK_MMC_DRIVER=y
CONFIG_RTK_SD_DRIVER=y
CONFIG_SYS_CONFIG_NAME="rtd1296_qa_emmc_bananapi"
#
# Enabled commands
#
CONFIG_CMD_UNZIP=y
CONFIG_CMD_SOURCE=y
CONFIG_CMD_GETTIME=y
CONFIG_CMD_GICTEST=y
CONFIG_CMD_CACHETEST=y
CONFIG_CMD_BOOTR=y
CONFIG_CMD_BOOTM=y
CONFIG_CMD_NET=y
CONFIG_CMD_TFTPPUT=y
CONFIG_CMD_USB=y
CONFIG_CMD_FASTBOOT=y
CONFIG_CMD_I2C=y
CONFIG_USB=y
CONFIG_USB_RTK=y
CONFIG_USB_EHCI_HCD=y
CONFIG_USB_EHCI_RTK=y
CONFIG_USB_XHCI_HCD=y
CONFIG_USB_XHCI_RTK=y
CONFIG_USB_STORAGE=y
CONFIG_USB_GADGET=y
CONFIG_USB_GADGET_RTK=y
CONFIG_USB_DWC3=y
CONFIG_USB_DWC3_GADGET=y
CONFIG_USB_DWC3_RTK=y
CONFIG_USBDOWNLOAD_GADGET=y
CONFIG_FASTBOOT_RTK=y
CONFIG_GMT_G2227=y

#
# Disabled commands
#

# CONFIG_CMD_NFS is not set
# CONFIG_CMD_IMLS is not set
# CONFIG_CMD_FPGA is not set
# CONFIG_CMD_BOOTD is not set
# CONFIG_CMD_CRC32 is not set
# CONFIG_CMD_ECHO is not set
# CONFIG_CMD_ITEST is not set
# CONFIG_CMD_XIMG is not set
# CONFIG_CMD_MISC is not set
# CONFIG_CMD_SETGETDCR is not set
# CONFIG_CMD_IMI is not set
# CONFIG_CMD_IMPORTENV is not set
# CONFIG_CMD_EXPORTENV is not set
# CONFIG_CMD_RUN is not set
# CONFIG_CMD_BASE is not set
# CONFIG_CMD_LOOP is not set
# CONFIG_CMD_TEST is not set
# CONFIG_CMD_TRUE is not set
# CONFIG_CMD_FALSE is not set
# CONFIG_CMD_LOADS is not set
CONFIG_CMD_LOADB=y
# CONFIG_CMD_EXIT is not set
# CONFIG_CMD_CONSOLE is not set
# CONFIG_CMD_SHOWVAR is not set
# CONFIG_CMD_MM is not set
# CONFIG_CMD_NM is not set
# CONFIG_CMD_CMP is not set
# CONFIG_CMD_CP is not set
```

## package/boot/uboot-realtek/src/drivers/pcb_mgr/Kconfig
```kconfig
menu "Pcb for flash type control"
	  
config FLASH_TYPE_CHOOSE
	bool "open and build the pcb_utils"
	help
	  Support for the build the flash type choose	  
	   

endmenu
```

## package/boot/uboot-realtek/src/drivers/usb/dwc3/Kconfig
```kconfig
config USB_DWC3
	bool "DesignWare USB3 DRD Core Support"
	depends on USB_HOST || USB_GADGET
	help
	  Say Y here if your system has a Dual Role SuperSpeed
	  USB controller based on the DesignWare USB3 IP Core.

if USB_DWC3

choice
	bool "DWC3 Mode Selection"

config USB_DWC3_HOST
	bool "Host only mode"
	depends on USB
	help
	  Select this when you want to use DWC3 in host mode only,
	  thereby the gadget feature will be regressed.

config USB_DWC3_GADGET
	bool "Gadget only mode"
	depends on USB_GADGET
	select USB_GADGET_DUALSPEED
	help
	  Select this when you want to use DWC3 in gadget mode only,
	  thereby the host feature will be regressed.

endchoice

comment "Platform Glue Driver Support"

config USB_DWC3_OMAP
	bool "Texas Instruments OMAP5 and similar Platforms"
	help
	  Some platforms from Texas Instruments like OMAP5, DRA7xxx and
	  AM437x use this IP for USB2/3 functionality.

	  Say 'Y' here if you have one such device

config USB_DWC3_RTK
	bool "Realtek USB DWC3 driver"
	help
	  Realtek support usb dwc3 device driver on SOC

menu "PHY Subsystem"

config USB_DWC3_PHY_OMAP
	bool "TI OMAP SoC series USB DRD PHY driver"
	help
	  Enable single driver for both USB2 PHY programming and USB3 PHY
	  programming for TI SoCs.

config USB_DWC3_PHY_SAMSUNG
	bool "Exynos5 SoC series USB DRD PHY driver"
	help
	  Enable USB DRD PHY support for Exynos 5 SoC series.
	  This driver provides PHY interface for USB 3.0 DRD controller
	  present on Exynos5 SoC series.

endmenu

endif
```
