## package/boot/uboot-rk35/src/configs/rv1126-spl-spi-nand_defconfig
```kconfig
CONFIG_ARM=y
CONFIG_ARCH_ROCKCHIP=y
CONFIG_SPL_LIBCOMMON_SUPPORT=y
CONFIG_SPL_LIBGENERIC_SUPPORT=y
CONFIG_SYS_MALLOC_F_LEN=0x80000
CONFIG_SPL_FIT_GENERATOR="arch/arm/mach-rockchip/make_fit_optee.sh"
CONFIG_ROCKCHIP_RV1126=y
CONFIG_ROCKCHIP_SPL_RESERVE_IRAM=0x0
# CONFIG_SPL_MMC_SUPPORT is not set
CONFIG_ROCKCHIP_FIT_IMAGE=y
CONFIG_ROCKCHIP_UIMAGE=y
CONFIG_ROCKCHIP_FIT_IMAGE_PACK=y
CONFIG_ROCKCHIP_UART_MUX_SEL_M=2
CONFIG_ROCKCHIP_SFC_IOMUX=y
CONFIG_SPL_SERIAL_SUPPORT=y
CONFIG_SPL_DRIVERS_MISC_SUPPORT=y
CONFIG_TARGET_EVB_RV1126=y
CONFIG_SPL_LIBDISK_SUPPORT=y
CONFIG_SPL_SPI_SUPPORT=y
CONFIG_DEFAULT_DEVICE_TREE="rv1126-evb"
CONFIG_DEBUG_UART=y
CONFIG_FIT=y
CONFIG_FIT_IMAGE_POST_PROCESS=y
CONFIG_FIT_HW_CRYPTO=y
CONFIG_SPL_LOAD_FIT=y
CONFIG_SPL_FIT_IMAGE_POST_PROCESS=y
CONFIG_SPL_FIT_HW_CRYPTO=y
# CONFIG_SPL_SYS_DCACHE_OFF is not set
CONFIG_BOOTDELAY=0
# CONFIG_CONSOLE_MUX is not set
CONFIG_SYS_CONSOLE_INFO_QUIET=y
# CONFIG_DISPLAY_CPUINFO is not set
CONFIG_ANDROID_BOOTLOADER=y
# CONFIG_ANDROID_WRITE_KEYBOX is not set
# CONFIG_ANDROID_KEYMASTER_CA is not set
CONFIG_ANDROID_BOOT_IMAGE_HASH=y
CONFIG_SPL_BOARD_INIT=y
# CONFIG_SPL_RAW_IMAGE_SUPPORT is not set
# CONFIG_SPL_LEGACY_IMAGE_SUPPORT is not set
# CONFIG_SYS_MMCSD_RAW_MODE_U_BOOT_USE_SECTOR is not set
CONFIG_SPL_SHA256_SUPPORT=y
CONFIG_SPL_CRYPTO_SUPPORT=y
CONFIG_SPL_HASH_SUPPORT=y
CONFIG_SPL_MTD_SUPPORT=y
CONFIG_SPL_MTD_WRITE=y
CONFIG_SPL_OPTEE=y
CONFIG_FASTBOOT_BUF_ADDR=0x800800
CONFIG_FASTBOOT_BUF_SIZE=0x04000000
CONFIG_FASTBOOT_FLASH=y
CONFIG_FASTBOOT_FLASH_MMC_DEV=0
# CONFIG_CMD_ELF is not set
# CONFIG_CMD_IMI is not set
# CONFIG_CMD_IMLS is not set
# CONFIG_CMD_XIMG is not set
# CONFIG_CMD_FLASH is not set
# CONFIG_CMD_FPGA is not set
CONFIG_CMD_GPT=y
# CONFIG_CMD_LOADB is not set
# CONFIG_CMD_LOADS is not set
CONFIG_CMD_BOOT_ANDROID=y
CONFIG_CMD_BOOT_ROCKCHIP=y
CONFIG_CMD_MMC=y
CONFIG_CMD_MTD=y
CONFIG_CMD_NAND=y
CONFIG_CMD_SF=y
CONFIG_CMD_SPI=y
CONFIG_CMD_USB=y
CONFIG_CMD_USB_MASS_STORAGE=y
# CONFIG_CMD_ITEST is not set
# CONFIG_CMD_SETEXPR is not set
CONFIG_CMD_TFTPPUT=y
CONFIG_CMD_TFTP_BOOTM=y
CONFIG_CMD_TFTP_FLASH=y
# CONFIG_CMD_NFS is not set
# CONFIG_CMD_MISC is not set
# CONFIG_CMD_CHARGE_DISPLAY is not set
CONFIG_CMD_MTD_BLK=y
# CONFIG_ISO_PARTITION is not set
CONFIG_EFI_PARTITION_ENTRIES_NUMBERS=64
CONFIG_SPL_OF_CONTROL=y
CONFIG_SPL_DTB_MINIMUM=y
CONFIG_OF_LIVE=y
CONFIG_OF_SPL_REMOVE_PROPS="pinctrl-0 pinctrl-names interrupt-parent assigned-clocks assigned-clock-rates assigned-clock-parents"
CONFIG_OF_U_BOOT_REMOVE_PROPS="interrupt-parent"
CONFIG_NET_RANDOM_ETHADDR=y
CONFIG_REGMAP=y
CONFIG_SPL_REGMAP=y
CONFIG_SYSCON=y
CONFIG_SPL_SYSCON=y
CONFIG_CLK=y
CONFIG_SPL_CLK=y
CONFIG_DM_CRYPTO=y
CONFIG_SPL_DM_CRYPTO=y
CONFIG_ROCKCHIP_CRYPTO_V2=y
CONFIG_SPL_ROCKCHIP_CRYPTO_V2=y
CONFIG_ROCKCHIP_GPIO=y
CONFIG_SYS_I2C_ROCKCHIP=y
CONFIG_DM_KEY=y
CONFIG_RK8XX_PWRKEY=y
CONFIG_ADC_KEY=y
CONFIG_MISC=y
CONFIG_SPL_MISC=y
CONFIG_MISC_DECOMPRESS=y
CONFIG_SPL_MISC_DECOMPRESS=y
CONFIG_ROCKCHIP_OTP=y
CONFIG_ROCKCHIP_HW_DECOMPRESS=y
CONFIG_SPL_ROCKCHIP_HW_DECOMPRESS=y
CONFIG_SPL_ROCKCHIP_SECURE_OTP=y
CONFIG_MMC_DW=y
CONFIG_MMC_DW_ROCKCHIP=y
CONFIG_MTD=y
CONFIG_MTD_BLK=y
CONFIG_MTD_DEVICE=y
CONFIG_NAND=y
CONFIG_NAND_ROCKCHIP=y
CONFIG_SYS_NAND_U_BOOT_LOCATIONS=y
CONFIG_SYS_NAND_U_BOOT_OFFS=0x4000
CONFIG_SYS_NAND_U_BOOT_OFFS_REDUND=0x10000
CONFIG_MTD_SPI_NAND=y
# CONFIG_SPI_NAND_GIGADEVICE is not set
# CONFIG_SPI_NAND_TOSHIBA is not set
# CONFIG_SPI_NAND_WINBOND is not set
# CONFIG_SPI_NAND_DOSILICON is not set
# CONFIG_SPI_NAND_HYF is not set
# CONFIG_SPI_NAND_FMSH is not set
# CONFIG_SPI_NAND_FORESEE is not set
# CONFIG_SPI_NAND_BIWIN is not set
# CONFIG_SPI_NAND_ETRON is not set
# CONFIG_SPI_NAND_JSC is not set
CONFIG_SF_DEFAULT_MODE=0x1
CONFIG_SF_DEFAULT_SPEED=50000000
CONFIG_DM_ETH=y
CONFIG_DM_ETH_PHY=y
CONFIG_DWC_ETH_QOS=y
CONFIG_GMAC_ROCKCHIP=y
CONFIG_PHY_ROCKCHIP_NANENG_USB2=y
CONFIG_PINCTRL=y
CONFIG_DM_FUEL_GAUGE=y
CONFIG_POWER_FG_RK817=y
CONFIG_IO_DOMAIN=y
CONFIG_ROCKCHIP_IO_DOMAIN=y
CONFIG_DM_PMIC=y
# CONFIG_SPL_PMIC_CHILDREN is not set
CONFIG_PMIC_RK8XX=y
CONFIG_REGULATOR_PWM=y
CONFIG_DM_REGULATOR_FIXED=y
CONFIG_REGULATOR_RK8XX=y
CONFIG_DM_CHARGE_DISPLAY=y
CONFIG_CHARGE_ANIMATION=y
CONFIG_PWM_ROCKCHIP=y
CONFIG_RAM=y
CONFIG_SPL_RAM=y
CONFIG_TPL_RAM=y
CONFIG_ROCKCHIP_SDRAM_COMMON=y
CONFIG_DM_RESET=y
CONFIG_SPL_DM_RESET=y
CONFIG_SPL_RESET_ROCKCHIP=y
CONFIG_BAUDRATE=1500000
CONFIG_DEBUG_UART_BASE=0xff570000
CONFIG_DEBUG_UART_CLOCK=24000000
CONFIG_DEBUG_UART_SHIFT=2
CONFIG_ROCKCHIP_SFC=y
CONFIG_SYSRESET=y
CONFIG_USB=y
CONFIG_USB_EHCI_HCD=y
CONFIG_USB_EHCI_GENERIC=y
CONFIG_USB_DWC3=y
CONFIG_USB_DWC3_GADGET=y
CONFIG_USB_STORAGE=y
CONFIG_USB_GADGET=y
CONFIG_USB_GADGET_MANUFACTURER="Rockchip"
CONFIG_USB_GADGET_VENDOR_NUM=0x2207
CONFIG_USB_GADGET_PRODUCT_NUM=0x110b
CONFIG_USB_GADGET_DOWNLOAD=y
CONFIG_DM_VIDEO=y
CONFIG_DISPLAY=y
CONFIG_DRM_ROCKCHIP=y
CONFIG_DRM_ROCKCHIP_INNO_MIPI_PHY=y
CONFIG_DRM_ROCKCHIP_DW_MIPI_DSI=y
CONFIG_DRM_ROCKCHIP_RGB=y
CONFIG_USE_TINY_PRINTF=y
CONFIG_SPL_TINY_MEMSET=y
CONFIG_RSA=y
CONFIG_SPL_RSA=y
CONFIG_RSA_N_SIZE=0x100
CONFIG_RSA_E_SIZE=0x100
CONFIG_RSA_C_SIZE=0x14
CONFIG_SHA512=y
CONFIG_ERRNO_STR=y
# CONFIG_EFI_LOADER is not set
CONFIG_OPTEE_CLIENT=y
CONFIG_OPTEE_V2=y
```

## package/boot/uboot-rk35/src/drivers/bootcount/Kconfig
```kconfig
#
# Boot count configuration
#

menu "Boot count support"

config BOOTCOUNT
	bool "Enable Boot count support"
	help
	  Enable boot count support, which provides the ability to store the
	  number of times the board has booted on a number of different
	  persistent storage mediums.

if BOOTCOUNT

config BOOTCOUNT_EXT
	bool "Boot counter on EXT filesystem"
	help
	  Add support for maintaining boot count in a file on an EXT
	  filesystem.

if BOOTCOUNT_EXT

config SYS_BOOTCOUNT_EXT_INTERFACE
	string "Interface on which to find boot counter EXT filesystem"
	default "mmc"
	depends on BOOTCOUNT_EXT
	help
	  Set the interface to use when locating the filesystem to use for the
	  boot counter.

config SYS_BOOTCOUNT_EXT_DEVPART
	string "Partition of the boot counter EXT filesystem"
	default "0:1"
	depends on BOOTCOUNT_EXT
	help
	  Set the partition to use when locating the filesystem to use for the
	  boot counter.

config SYS_BOOTCOUNT_EXT_NAME
	string "Path and filename of the EXT filesystem based boot counter"
	default "/boot/failures"
	depends on BOOTCOUNT_EXT
	help
	  Set the filename and path of the file used to store the boot counter.

config SYS_BOOTCOUNT_ADDR
	hex "RAM address used for reading and writing the boot counter"
	default 0x7000A000
	depends on BOOTCOUNT_EXT
	help
	  Set the address used for reading and writing the boot counter.

endif

endif

endmenu
```

## package/boot/uboot-rk35/src/drivers/clk/rockchip/Kconfig
```kconfig
config ROCKCHIP_CLK_PLL
	bool "Rockchip PLL clock drivers"
	depends on CLK
	default y if !ROCKCHIP_IMAGE_TINY
	help
	  Enable support for pll clocks on Rockchip SoCs.
```

## package/boot/uboot-rk35/src/drivers/cpu/amp.its
```
/*
 * Copyright (C) 2021 Fuzhou Rockchip Electronics Co., Ltd
 * SPDX-License-Identifier: GPL-2.0
 */

/dts-v1/;
/ {
	description = "FIT source file for rockchip AMP";
	#address-cells = <1>;

	images {
		amp1 {
			description  = "bare-mental-core1";
			data         = /incbin/("./amp1.bin");
			type         = "firmware";
			compression  = "none";
			arch         = "arm";		// "arm64" or "arm"
			cpu          = <0x100>;		// mpidr
			thumb        = <0>;		// 0: arm or thumb2; 1: thumb
			hyp          = <0>;		// 0: el1/svc; 1: el2/hyp
			load         = <0x01800000>;
			udelay       = <1000000>;
			hash {
				algo = "sha256";
			};
		};

		amp2 {
			description  = "bare-mental-core2";
			data         = /incbin/("./amp2.bin");
			type         = "firmware";
			compression  = "none";
			arch         = "arm";
			cpu          = <0x200>;
			thumb        = <0>;
			hyp          = <0>;
			load         = <0x03800000>;
			udelay       = <1000000>;
			hash {
				algo = "sha256";
			};
		};

		amp3 {
			description  = "bare-mental-core3";
			data         = /incbin/("./amp3.bin");
			type         = "firmware";
			compression  = "none";
			arch         = "arm";
			cpu          = <0x300>;
			thumb        = <0>;
			hyp          = <0>;
			load         = <0x05800000>;
			udelay       = <1000000>;
			hash {
				algo = "sha256";
			};
		};
	};

	configurations {
		default = "conf";
		conf {
			description = "Rockchip AMP images";
			rollback-index = <0x0>;
			loadables = "amp1", "amp2", "amp3";

			signature {
				algo = "sha256,rsa2048";
				padding = "pss";
				key-name-hint = "dev";
				sign-images = "loadables";
			};

			/* - run linux on cpu0
			 * - it is brought up by amp(that run on U-Boot)
			 * - it is boot entry depends on U-Boot
			 */
			linux {
				description  = "linux-os";
				arch         = "arm64";
				cpu          = <0x000>;
				thumb        = <0>;
				hyp          = <0>;
				udelay       = <1000000>;
			};
		};
	};
};
```

## package/boot/uboot-rk35/src/drivers/crypto/rockchip/Kconfig
```kconfig
config ROCKCHIP_RSA
	bool "Enable rockchip RSA support"
	depends on ROCKCHIP_CRYPTO_V1 || ROCKCHIP_CRYPTO_V2
	default y
	help
	  This enable RSA512/RSA1024/RSA2048 algorithm support for
	  rockchip crypto module.

config SPL_ROCKCHIP_RSA
	bool "Enable rockchip RSA support in spl"
	depends on SPL_ROCKCHIP_CRYPTO_V1 || SPL_ROCKCHIP_CRYPTO_V2
	default y
	help
	  This enable RSA512/RSA1024/RSA2048 algorithm support for
	  rockchip crypto module.

config ROCKCHIP_CIPHER
	bool "Enable rockchip cipher support"
	depends on ROCKCHIP_CRYPTO_V1 || ROCKCHIP_CRYPTO_V2
	default n
	help
	  This enable DES/AES/SM4 algorithm support for
	  rockchip crypto module.

config SPL_ROCKCHIP_CIPHER
	bool "Enable rockchip cipher support in spl"
	depends on SPL_ROCKCHIP_CRYPTO_V1 || SPL_ROCKCHIP_CRYPTO_V2
	default n
	help
	  This enable DES/AES/SM4 algorithm support for
	  rockchip crypto module.

config ROCKCHIP_HMAC
	bool "Enable rockchip hmac support"
	depends on ROCKCHIP_CRYPTO_V1 || ROCKCHIP_CRYPTO_V2
	default n
	help
	  This enable HMAC algorithm support for
	  rockchip crypto module.

config SPL_ROCKCHIP_HMAC
	bool "Enable rockchip hmac support in spl"
	depends on SPL_ROCKCHIP_CRYPTO_V1 || SPL_ROCKCHIP_CRYPTO_V2
	default n
	help
	  This enable HMAC algorithm support for
	  rockchip crypto module.

config ROCKCHIP_CRYPTO_V1
	bool "Enable rockchip crypto v1 support"
	depends on DM_CRYPTO
	help
	  This enable MD5/SHA1/SHA256/RSA512/RSA1024/RSA2048 algorithm support for
	  rockchip crypto v1 on platforms: rk3399/rk3368/rk3328/rk3229/rk3288/rk3128.

config SPL_ROCKCHIP_CRYPTO_V1
	bool "Enable rockchip crypto v1 support in spl"
	depends on SPL_DM_CRYPTO
	help
	  This enable MD5/SHA1/SHA256/RSA512/RSA1024/RSA2048 algorithm support for
	  rockchip crypto v1 on platforms: rk3399/rk3368/rk3328/rk3229/rk3288/rk3128.

config ROCKCHIP_CRYPTO_V2
	bool "Enable rockchip crypto v2 support"
	depends on DM_CRYPTO
	help
	  This enable MD5/SHA1/SHA256/RSA512/RSA1024/RSA2048 algorithm support for
	  rockchip crypto v2 on platforms: px30/rk3326/rk1808/rk3308.

config SPL_ROCKCHIP_CRYPTO_V2
	bool "Enable rockchip crypto v2 support in spl"
	depends on SPL_DM_CRYPTO
	help
	  This enable MD5/SHA1/SHA256/RSA512/RSA1024/RSA2048 algorithm support for
	  rockchip crypto v2 on platforms: px30/rk3326/rk1808/rk3308.
```

## package/boot/uboot-rk35/src/drivers/firmware/scmi/Kconfig
```kconfig
config SCMI_FIRMWARE
	bool "Enable SCMI support"
	select FIRMWARE
	select OF_TRANSLATE
	depends on SANDBOX || DM_MAILBOX || ARM_SMCCC
	help
	  System Control and Management Interface (SCMI) is a communication
	  protocol that defines standard interfaces for power, performance
	  and system management. The SCMI specification is available at
	  https://developer.arm.com/architectures/system-architectures/software-standards/scmi

	  An SCMI agent communicates with a related SCMI server firmware
	  located in another sub-system, as a companion micro controller
	  or a companion host in the CPU system.

	  Communications between agent (client) and the SCMI server are
	  based on message exchange. Messages can be exchange over tranport
	  channels as a mailbox device or an Arm SMCCC service with some
	  piece of identified shared memory.

config SPL_SCMI_FIRMWARE
	bool "Enable SPL SCMI support"
	select FIRMWARE
	select OF_TRANSLATE
	depends on SANDBOX || DM_MAILBOX || ARM_SMCCC
	help
	  Ditto as SCMI_FIRMWARE.
```
