/*
*  GPU DVFS table 
*/

/ {
    gpu@0x98050000 {
        compatible = "arm,mali-midgard";
        operating-points = <
        /* KHz uV */
        620000 1100000
        600000 1100000
        580000 1075000
        560000 1075000
        540000 1050000
        520000 1025000
        500000 1000000
        460000 1000000
        440000 1000000
        400000 1000000
        380000 975000
        >;
    };
};
