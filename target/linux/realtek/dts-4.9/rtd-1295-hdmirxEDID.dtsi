/*
 * rtd-1295-hdmirxEDID.dtsi - HDMI Rx EDID table for REALTEK 1295 SoC
 */

/{
	hdmirx@98034000 {
		Realtek,edid-table = <
			0x00 0xFF 0xFF 0xFF 0xFF 0xFF 0xFF 0x00 0x4A 0x8B 0x95
			0x12 0x00 0x00 0x00 0x00 0xFF 0x1A 0x01 0x03 0x81 0x46
			0x27 0x78 0x8A 0xA5 0x8E 0xA6 0x54 0x4A 0x9C 0x26 0x12
			0x45 0x46 0x21 0x08 0x00 0xD1 0xC0 0x81 0xC0 0x01 0x01
			0x01 0x01 0x01 0x01 0x01 0x01 0x01 0x01 0x01 0x01 0x02
			0x3A 0x80 0x18 0x71 0x38 0x2D 0x40 0x58 0x2C 0x45 0x00
			0x20 0xC2 0x31 0x00 0x00 0x1E 0x01 0x1D 0x00 0x72 0x51
			0xD0 0x1E 0x20 0x6E 0x28 0x55 0x00 0x20 0xC2 0x31 0x00
			0x00 0x1E 0x00 0x00 0x00 0xFD 0x00 0x32 0x4B 0x18 0x3C
			0x0B 0x00 0x0A 0x20 0x20 0x20 0x20 0x20 0x20 0x00 0x00
			0x00 0xFC 0x00 0x52 0x54 0x44 0x31 0x32 0x39 0x35 0x0A
			0x20 0x20 0x20 0x20 0x20 0x01 0xAC 0x02 0x03 0x29 0x71
			0x83 0x01 0x00 0x00 0x6E 0x03 0x0C 0x00 0x10 0x00 0x00
			0x3C 0x20 0x00 0x80 0x01 0x02 0x03 0x04 0x49 0x90 0x1F
			0x22 0x20 0x05 0x14 0x04 0x11 0x02 0x23 0x09 0x7F 0x07
			0xE3 0x05 0x03 0x00 0x02 0x3A 0x80 0x18 0x71 0x38 0x2D
			0x40 0x58 0x2C 0x45 0x00 0x20 0xC2 0x31 0x00 0x00 0x1E
			0x00 0x00 0x00 0x00 0x00 0x00 0x00 0x00 0x00 0x00 0x00
			0x00 0x00 0x00 0x00 0x00 0x00 0x00 0x00 0x00 0x00 0x00
			0x00 0x00 0x00 0x00 0x00 0x00 0x00 0x00 0x00 0x00 0x00
			0x00 0x00 0x00 0x00 0x00 0x00 0x00 0x00 0x00 0x00 0x00
			0x00 0x00 0x00 0x00 0x00 0x00 0x00 0x00 0x00 0x00 0x00
			0x00 0x00 0x00 0x00 0x00 0x00 0x00 0x00 0x00 0x00 0x00
			0x00 0x00 0x7F>;

		Realtek,edid2p0-table = <
			0x00 0xFF 0xFF 0xFF 0xFF 0xFF 0xFF 0x00 0x4A 0x8B 0x95
			0x12 0x00 0x00 0x00 0x00 0xFF 0x1A 0x01 0x03 0x81 0x46
			0x27 0x78 0x8A 0xA5 0x8E 0xA6 0x54 0x4A 0x9C 0x26 0x12
			0x45 0x46 0x21 0x08 0x00 0xD1 0xC0 0x81 0xC0 0x01 0x01
			0x01 0x01 0x01 0x01 0x01 0x01 0x01 0x01 0x01 0x01 0x02
			0x3A 0x80 0x18 0x71 0x38 0x2D 0x40 0x58 0x2C 0x45 0x00
			0x20 0xC2 0x31 0x00 0x00 0x1E 0x01 0x1D 0x00 0x72 0x51
			0xD0 0x1E 0x20 0x6E 0x28 0x55 0x00 0x20 0xC2 0x31 0x00
			0x00 0x1E 0x00 0x00 0x00 0xFD 0x00 0x32 0x4B 0x18 0x3C
			0x0B 0x00 0x0A 0x20 0x20 0x20 0x20 0x20 0x20 0x00 0x00
			0x00 0xFC 0x00 0x52 0x54 0x44 0x31 0x32 0x39 0x35 0x0A
			0x20 0x20 0x20 0x20 0x20 0x01 0xAC 0x02 0x03 0x3A 0x71
			0x83 0x01 0x00 0x00 0x6E 0x03 0x0C 0x00 0x10 0x00 0x00
			0x3C 0x20 0x00 0x80 0x01 0x02 0x03 0x04 0x67 0xD8 0x5D
			0xC4 0x01 0x77 0x80 0x00 0x4F 0x5D 0x5E 0x5F 0x60 0x61
			0x62 0x90 0x1F 0x22 0x20 0x05 0x14 0x04 0x11 0x02 0x23
			0x09 0x7F 0x07 0xE3 0x05 0x03 0x00 0xE2 0x0F 0x18 0x08
			0xE8 0x00 0x30 0xF2 0x70 0x5A 0x80 0xB0 0x58 0x8A 0x00
			0x20 0xC2 0x31 0x00 0x00 0x1E 0x00 0x00 0x00 0x00 0x00
			0x00 0x00 0x00 0x00 0x00 0x00 0x00 0x00 0x00 0x00 0x00
			0x00 0x00 0x00 0x00 0x00 0x00 0x00 0x00 0x00 0x00 0x00
			0x00 0x00 0x00 0x00 0x00 0x00 0x00 0x00 0x00 0x00 0x00
			0x00 0x00 0x00 0x00 0x00 0x00 0x00 0x00 0x00 0x00 0x00
			0x00 0x00 0x8F>;
	};
};
