/ {
	aliases {
		mmc0 = &sdmmc;
		mmc1 = &sdio;
		mmc2 = &sdhci;
	};
};

&gmac1 {
	snps,reset-gpio = <&gpio3 RK_PB7 GPIO_ACTIVE_LOW>;
	snps,reset-active-low;
	/* Reset time is 15ms, 50ms for rtl8211f */
	snps,reset-delays-us = <0 20000 100000>;
};

&sdmmc {
	cd-gpios = <&gpio0 RK_PA4 GPIO_ACTIVE_LOW>;
};
