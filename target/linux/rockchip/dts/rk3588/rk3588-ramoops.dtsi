/ {
	reserved-memory {
		#address-cells = <2>;
		#size-cells = <2>;
		ranges;

		ramoops: ramoops@118000 {
			compatible = "ramoops";
			reg = <0 0x118000 0 0xd8000>;
			console-size = <0x80000>;
			ftrace-size = <0x00000>;
			pmsg-size = <0x30000>;
			record-size = <0x14000>;
		};
	};
};
