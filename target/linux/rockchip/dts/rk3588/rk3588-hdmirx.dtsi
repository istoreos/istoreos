/*
 * Copyright (c) 2021 Rockchip Electronics Co., Ltd.
 * Copyright (c) 2026 jjm2473 <jjm2473@gmail.com>
 */

&hdmi_receiver {
	compatible = "rockchip,rk3588-hdmirx-ctrler", "rockchip,hdmirx-ctrler";
	pinctrl-0 = <&hdmim1_rx_cec &hdmim1_rx_hpdin &hdmim1_rx_scl &hdmim1_rx_sda>;
	pinctrl-names = "default";
};
