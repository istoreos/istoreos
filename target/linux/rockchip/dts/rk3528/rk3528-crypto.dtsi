/*
 * Copyright (c) 2022 Rockchip Electronics Co., Ltd.
 * Copyright (c) 2025 jjm2473 <jjm2473@gmail.com>
 */

/ {
	soc {
		crypto: crypto@ffc40000 {
			compatible = "rockchip,crypto-v4";
			reg = <0x0 0xffc40000 0x0 0x2000>;
			interrupts = <GIC_SPI 19 IRQ_TYPE_LEVEL_HIGH>;
			clocks = <&scmi_clk SCMI_ACLK_CRYPTO>, <&scmi_clk SCMI_HCLK_CRYPTO>,
				<&scmi_clk SCMI_CORE_CRYPTO>, <&scmi_clk SCMI_PKA_CRYPTO>;
			clock-names = "aclk", "hclk", "sclk", "pka";
			assigned-clocks = <&scmi_clk SCMI_CORE_CRYPTO>, <&scmi_clk SCMI_PKA_CRYPTO>;
			assigned-clock-rates = <300000000>, <300000000>;
			resets = <&cru SRST_CORE_CRYPTO>;
			reset-names = "crypto-rst";
			status = "disabled";
		};

		rng: rng@ffc50000 {
			compatible = "rockchip,rkrng";
			reg = <0x0 0xffc50000 0x0 0x200>;
			interrupts = <GIC_SPI 23 IRQ_TYPE_LEVEL_HIGH>;
			clocks = <&scmi_clk SCMI_HCLK_TRNG>;
			clock-names = "hclk_trng";
			resets = <&cru SRST_H_TRNG_NS>;
			reset-names = "reset";
			status = "disabled";
		};
	};
};

&crypto {
	status = "okay";
};

&rng {
	status = "okay";
};
