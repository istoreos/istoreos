/*
 * Copyright (c) 2022 Rockchip Electronics Co., Ltd.
 * Copyright (c) 2025 jjm2473 <jjm2473@gmail.com>
 */

/ {

};

#include "rk3528-vpu.dtsi"
#include "rk3528-gpu.dtsi"
#include "rk3528-crypto.dtsi"
