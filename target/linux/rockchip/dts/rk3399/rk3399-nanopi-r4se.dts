
/dts-v1/;
#include "rk3399-nanopi-r4s.dts"

/ {
	model = "FriendlyElec NanoPi R4SE";
	compatible = "friendlyarm,nanopi-r4se", "rockchip,rk3399";
};

&emmc_phy {
	status = "okay";
};

&sdhci {
	mmc-hs400-1_8v;
	mmc-hs400-enhanced-strobe;
	status = "okay";
};
