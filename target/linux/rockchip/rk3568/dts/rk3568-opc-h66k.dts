// SPDX-License-Identifier: (GPL-2.0+ OR MIT)
/*
 * Copyright (c) 2020 Rockchip Electronics Co., Ltd.
 * Copyright (c) 2022 Flippy <flippy@sina.com>
 */

/dts-v1/;

#include "rk3568-hinlink.dtsi"

/ {
	model = "HINLINK OPC-H66K Board";
	compatible = "hinlink,opc-h66k", "rockchip,rk3568";
};

&gmac0 {
	status = "disabled";
};

&gmac1 {
	status = "disabled";
};
