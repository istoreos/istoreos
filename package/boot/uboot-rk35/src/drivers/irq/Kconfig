## package/boot/uboot-rk35/src/drivers/power/dvfs/Kconfig
```kconfig
config DM_DVFS
	bool "Enable Driver Model for DVFS drivers (UCLASS_DVFS)"
	depends on DM
	---help---
	This config enables the driver-model DVFS support.

config ROCKCHIP_WTEMP_DVFS
	bool "Enable rockchip wide temperature dvfs policy"
	depends on DM_DVFS && ROCKCHIP_THERMAL && USING_KERNEL_DTB
	help
	  This enable support wide temperature dvfs for rockchip platforms.
```

## package/boot/uboot-rk35/src/drivers/power/fuel_gauge/Kconfig
```kconfig
config DM_FUEL_GAUGE
	bool "Enable driver model fuel gauge support"
	depends on DM
	help
	  This adds a simple uclass for fuel gauge.

config SPL_DM_FUEL_GAUGE
	bool "Enable driver model fuel gauge support"
	depends on SPL_DM
	help
	  This adds a simple uclass for fuel gauge.

config POWER_FG_CW201X
	bool "CW201X Fuel gauge support"
	depends on DM_FUEL_GAUGE
	help
	  This adds support for CW201X fuel gauge support.

config SPL_POWER_FG_CW201X
	bool "CW201X Fuel gauge support"
	depends on SPL_DM_FUEL_GAUGE
	help
	  This adds support for CW201X fuel gauge support.

config POWER_FG_RK818
	bool "RK818 Fuel gauge support"
	depends on DM_FUEL_GAUGE && PMIC_RK8XX
	help
	  This adds support for RK818 fuel gauge support.

config SPL_POWER_FG_RK818
	bool "RK818 Fuel gauge support"
	depends on SPL_DM_FUEL_GAUGE && PMIC_RK8XX
	help
	  This adds support for RK818 fuel gauge support.

config POWER_FG_RK817
	bool "RK817 Fuel gauge support"
	depends on DM_FUEL_GAUGE && PMIC_RK8XX
	help
	  This adds support for RK817 fuel gauge support.

config SPL_POWER_FG_RK817
	bool "RK817 Fuel gauge support"
	depends on SPL_DM_FUEL_GAUGE && PMIC_RK8XX
	help
	  This adds support for RK817 fuel gauge support.

config POWER_FG_RK816
	bool "RK816 Fuel gauge support"
	depends on DM_FUEL_GAUGE && PMIC_RK8XX
	help
	  This adds support for RK816 fuel gauge support.

config SPL_POWER_FG_RK816
	bool "RK816 Fuel gauge support"
	depends on DM_FUEL_GAUGE && PMIC_RK8XX
	help
	  This adds support for RK816 fuel gauge support.

config SPL_POWER_LOW_VOLTAGE_THRESHOLD
	int "Set the low voltage threshold"
	default 3400
	depends on SPL_DM_FUEL_GAUGE
	help
	  Set the low voltage threshold. If the voltage, which is detected,
	  is lower than the low voltage threshold, load and boot the U-Boot
	  and goto charge the power.
```

## package/boot/uboot-rk35/src/drivers/power/io-domain/Kconfig
```kconfig
menu "IO Domain Support"

config IO_DOMAIN
	bool "Enable io domain support using Driver Model"
	depends on DM && OF_CONTROL
	help
	  Enable support for the io domain driver class. Many SoCs allow
	  power to be applied to or removed from portions of the SoC (io
	  domains). This may be used to save power. This API provides the
	  means to control such power management hardware.

config ROCKCHIP_IO_DOMAIN
	bool "Enable the rockchip io domain driver"
	depends on IO_DOMAIN && ARCH_ROCKCHIP
	help
	  Enable support for manipulating ROCKCHIP io domains via MMIO mapped
	  registers.

endmenu
```

## package/boot/uboot-rk35/src/drivers/power/power_delivery/Kconfig
```kconfig
# SPDX-License-Identifier: GPL-2.0

config DM_POWER_DELIVERY
	bool "Enable driver model power delivery support"
	depends on DM
	help
	  This adds a simple uclass for power delivery.

config TYPEC_TCPM
	tristate "USB Type-C Port Controller Manager"
	depends on DM && DM_POWER_DELIVERY
	help
	  The Type-C Port Controller Manager provides a USB PD and USB Type-C
	  state machine for use with Type-C Port Controllers.

config TYPEC_TCPCI
	tristate "Type-C Port Controller Interface driver"
	depends on DM && DM_POWER_DELIVERY && DM_I2C
	help
	  Type-C Port Controller driver for TCPCI-compliant controller.

if TYPEC_TCPCI

config TYPEC_HUSB311
	tristate "Hynetek HUSB311 Type-C chip driver"
	depends on DM && DM_POWER_DELIVERY && DM_I2C
	help
	  Hynetek HUSB311 Type-C chip driver that works with
	  Type-C Port Controller Manager to provide USB PD and USB
	  Type-C functionalities.

endif # TYPEC_TCPCI

config TYPEC_FUSB302
	tristate "Fairchild FUSB302 Type-C chip driver"
	depends on DM && DM_POWER_DELIVERY && DM_I2C
	help
	  The Fairchild FUSB302 Type-C chip driver that works with
	  Type-C Port Controller Manager to provide USB PD and USB
	  Type-C functionalities.
```

## package/boot/uboot-rk35/src/drivers/ram/rockchip/Kconfig
```kconfig
config ROCKCHIP_DMC
	bool "ROCKCHIP DMC"
	help
	  This enable dram devfreq driver.

config ROCKCHIP_DMC_FSP
	bool "Rockchip initialize DMC FSP"
	depends on DM_DMC && ROCKCHIP_SMCCC
	help
	  This enable support for Rockchip initialize frequency set point of dynamic memory
	  interface.

config ROCKCHIP_SDRAM_COMMON
	bool "Enable rockchip sdram common driver"
	depends on TPL_RAM || SPL_RAM
	help
	  This enable sdram common driver

config ROCKCHIP_DRAM_EXTENDED_TEMP_SUPPORT
	bool "enable rockchip dram extended temperature support"
	depends on TPL_RAM || SPL_RAM
	default n
	help
	  This enable dram dram extended temperature support

config ROCKCHIP_TPL_INIT_DRAM_TYPE
	int "TPL select DRAM type"
	depends on TPL_RAM || SPL_RAM
	default 3
	help
	  This choose DRAM type for TPL INIT code, 0 for DDR4, 2 for DDR2,
	  3 for DDR3, 5 for LPDDR2, 6 for LPDDR3, 7 for LPDDR4, all other
	  value are reserved.
```

## package/boot/uboot-rk35/src/drivers/rkflash/Kconfig
```kconfig
#
# Copyright (c) 2018 Fuzhou Rockchip Electronics Co., Ltd
#
# SPDX-License-Identifier: (GPL-2.0+ OR MIT)
#
if ARCH_ROCKCHIP

menuconfig RKFLASH
	bool "Rockchip Flash Devices support"
	default n
	help
	  This enables support for Rockchip Flash Devices including Nandc Slc
	  Nand, SFC SPI Nand and SFC SPI Nor.

	  They're block interface.

	  Say Y when you have a board with one of them.

if RKFLASH

comment "Rockchip Flash Devices"

config RKNANDC_NAND
	bool "Rockchip NANDC Slc Nand Devices support"
	depends on RKNAND != y
	default n
	help
	  This enables support for NANDC Slc Nand Devices.

	  It's block interface, 512Kb/sector.

	  Say Y when you have a board with Slc Nand Flash supported by Rockchip
	  Nandc controller.

config RKSFC_NAND
	bool "Rockchip SFC SPI Nand Devices support"
	depends on RKNAND != y
	default n
	help
	  This enables support for Rockchip SFC SPI Nand Devices.

	  It's block interface, 512Kb/sector.

	  Say Y when you have a board with SPI Nand Flash supported by Rockchip
          Serial Flash Controller(SFC).
config RKSFC_NOR
	bool "Rockchip SFC SPI Nor Devices Support"
	depends on BLK
	help
	  This enables support for Rockchip SFC SPI Nor Devices.

	  It's block interface,512Kb/sector.

	  Say Y when you have a board with SPI Nor Flash supported by Rockchip
	  Serial Flash Controller(SFC).

endif # RKFLASH

endif # ARCH_ROCKCHIP
```

## package/boot/uboot-rk35/src/drivers/rknand/Kconfig
```kconfig
#
# Copyright (C) (C) Copyright 2016-2017 Rockchip Electronics Co., Ltd
#
# SPDX-License-Identifier:	GPL-2.0+
#

config RKNAND
	bool "Rockchip NAND FLASH device support"
	depends on BLK
	select ZFTL if (ROCKCHIP_PX30 || ROCKCHIP_RK3568)
	help
	  This option enables support for Rockchip NAND FLASH devices.
	  It supports block interface(with rk ftl) to read and write NAND FLASH.

config ZFTL
	bool "Rockchip ZFTL for rkpx30/rk3326 to support 3D/2D TLC/MLC"
	depends on RKNAND && (ROCKCHIP_PX30 || ROCKCHIP_RK3568)
	default y if (ROCKCHIP_PX30 || ROCKCHIP_RK3568)
	help
	  This option enables support for Rockchip NAND FLASH devices.
	  It supports block interface(with zftl) to read and write 3D/2D TLC/MLC
	  NAND FLASH.
```

## package/boot/uboot-rk35/src/drivers/rng/Kconfig
```kconfig
config DM_RNG
	bool "Driver support for Random Number Generator devices"
	depends on DM
	help
	  Enable driver model for random number generator(rng) devices.
	  This interface is used to initialise the rng device and to
	  read the random seed from the device.

if DM_RNG

config RNG_ROCKCHIP
	bool "Enable random number generator for rockchip crypto rng"
	depends on ARCH_ROCKCHIP && DM_RNG
	default n
	help
	  Enable random number generator for rockchip.This driver is
	  support rng module of crypto v1 and crypto v2.

endif
```

## package/boot/uboot-rk35/src/drivers/usb/cdns3/Kconfig
```kconfig
config USB_CDNS3
	tristate "Cadence USB3 Dual-Role Controller"
	depends on USB_HOST || USB_GADGET
	help
	  Say Y here if your system has a Cadence USB3 dual-role controller.
	  It supports: Host-only, and Peripheral-only.

if USB_CDNS3

config USB_CDNS3_GADGET
	bool "Cadence USB3 device controller"
	depends on USB_GADGET
	select USB_GADGET_DUALSPEED
	help
	  Say Y here to enable device controller functionality of the
	  Cadence USBSS-DEV driver.

	  This controller supports FF and HS mode. It doesn't support
	  LS and SSP mode.

config USB_CDNS3_HOST
	bool "Cadence USB3 host controller"
	depends on USB_XHCI_HCD
	help
	  Say Y here to enable host controller functionality of the
	  Cadence driver.

	  Host controller is compliant with XHCI so it will use
	  standard XHCI driver.

config SPL_USB_CDNS3_GADGET
	bool "SPL support for Cadence USB3 device controller"
	depends on SPL_USB_GADGET
	select USB_GADGET_DUALSPEED
	help
	  Say Y here to enable device controller functionality of the
	  Cadence USBSS-DEV driver in SPL.

	  This controller supports FF and HS mode. It doesn't support
	  LS and SSP mode.

config SPL_USB_CDNS3_HOST
	bool "Cadence USB3 host controller"
	depends on USB_XHCI_HCD && SPL_USB_HOST_SUPPORT
	help
	  Say Y here to enable host controller functionality of the
	  Cadence driver.

	  Host controller is compliant with XHCI so it will use
	  standard XHCI driver.

config USB_CDNS3_TI
	tristate "Cadence USB3 support on TI platforms"
	default USB_CDNS3
	help
	  Say 'Y' here if you are building for Texas Instruments
	  platforms that contain Cadence USB3 controller core. E.g.: J721e.
endif
```

## package/boot/uboot-rk35/src/lib/avb/libavb/Kconfig
```kconfig
config AVB_LIBAVB
	bool "Support running U-Boot AVB"
	help
	  The new android bootloader need to startup
	  with a/b and avb.This config can add the
	  AVB functions to u-boot.

config SPL_AVB_LIBAVB
	bool "Support running U-Boot AVB for spl"
	help
	  The new android bootloader need to startup
	  with a/b and avb.This config can add the
	  AVB functions to u-boot.

config TPL_AVB_LIBAVB
	bool "Support running U-Boot AVB for tpl"
	help
	  The new android bootloader need to startup
	  with a/b and avb.This config can add the
	  AVB functions to u-boot.
```

## package/boot/uboot-rk35/src/lib/avb/libavb_ab/Kconfig
```kconfig
config AVB_LIBAVB_AB
	bool "Choose the a/b system and flow"
	help
	  In the android things system, there are
	  _a and _b or more systems. So we have to
	  choose the _a or _b system to startup.
	  This libavb_ab can suport these functions.

config SPL_AVB_LIBAVB_AB
	bool "Choose the a/b system and flow for spl"
	help
	  In the android things system, there are
	  _a and _b or more systems. So we have to
	  choose the _a or _b system to startup.
	  This libavb_ab can suport these functions.

config TPL_AVB_LIBAVB_AB
	bool "Choose the a/b system and flow for tpl"
	help
	  In the android things system, there are
	  _a and _b or more systems. So we have to
	  choose the _a or _b system to startup.
	  This libavb_ab can suport these functions.
```

## package/boot/uboot-rk35/src/lib/avb/libavb_atx/Kconfig
```kconfig
config AVB_LIBAVB_ATX
	bool "support vbmeta public key verify"
	help
	  Android Things requires specific public key
	  metadata and verification logic to correctly
	  verify vbmeta public keys.

config SPL_AVB_LIBAVB_ATX
	bool "support vbmeta public key verify for SPL"
	help
	  Android Things requires specific public key
	  metadata and verification logic to correctly
	  verify vbmeta public keys.

config TPL_AVB_LIBAVB_ATX
	bool "support vbmeta public key verify for TPL"
	help
	  Android Things requires specific public key
	  metadata and verification logic to correctly
	  verify vbmeta public keys.
```

## package/boot/uboot-rk35/src/lib/avb/libavb_user/Kconfig
```kconfig
config AVB_LIBAVB_USER
	bool "Android AVB read/write hardware"
	help
	  This config support the android things system to
	  read/write hardware image, like vbmeta, misc, and
	  so on. And it can provide some a/b and avb information
	  to fastboot and kernel.

config AVB_VBMETA_PUBLIC_KEY_VALIDATE
	bool "Support vbmeta public key validate"
	depends on AVB_LIBAVB_USER
	select CONSOLE_DISABLE_CLI
	help
	  support vbmeta public key validate, system bootflow would be
	  uninterruptale when it is enabled:
	    - only allow "boot_android" as bootcmd;
	    - enter rockusb or fastboot when boot failed;
	    - not allow ctrl+c to enter hush;
	  only the CONFIG_BOOTDELAY can interrupt the bootflow.

config SPL_AVB_LIBAVB_USER
	bool "Android AVB read/write hardware for spl"
	help
	  This config support the android things system to
	  read/write hardware image, like vbmeta, misc, and
	  so on. And it can provide some a/b and avb information
	  to fastboot and kernel.

config TPL_AVB_LIBAVB_USER
	bool "Android AVB read/write hardware for tpl"
	help
	  This config support the android things system to
	  read/write hardware image, like vbmeta, misc, and
	  so on. And it can provide some a/b and avb information
	  to fastboot and kernel.
```

## package/boot/uboot-rk35/src/lib/avb/rk_avb_user/Kconfig
```kconfig
config RK_AVB_LIBAVB_USER
	bool "Rockchip AVB support"
	help
	  This config support the android things system to
	  read/write hardware image, like vbmeta, misc, and
	  so on. And it can provide some a/b and avb information
	  to fastboot and kernel.

config SPL_RK_AVB_LIBAVB_USER
	bool "Rockchip AVB support for spl"
	help
	  This config support the android things system to
	  read/write hardware image, like vbmeta, misc, and
	  so on. And it can provide some a/b and avb information
	  to fastboot and kernel.

config TPL_RK_AVB_LIBAVB_USER
	bool "Rockchip AVB support for tpl"
	help
	  This config support the android things system to
	  read/write hardware image, like vbmeta, misc, and
	  so on. And it can provide some a/b and avb information

config ROCKCHIP_PRELOADER_PUB_KEY
	bool "Rockchip AVB use pre-loader public key"
	depends on AVB_LIBAVB_USER
	select CRYPTO_ROCKCHIP
	help
	  Use pre-loader public key to decode in avb.
```

## package/boot/uboot-rk35/src/lib/optee_clientApi/Kconfig
```kconfig
config OPTEE_CLIENT
	bool "Support OPTEE"
	help
	  U-boot can communicate with trust if
	  the config is enable. This function can
	  be use in android bootloader a/b and avb
	  step.

config OPTEE_V1
	bool "Support OPTEE version 1.0"
	depends on OPTEE_CLIENT
	help
	  U-boot can communicate with trust if
	  the config is enable. This function can
	  be use in android bootloader a/b and avb
	  step.

config OPTEE_V2
	bool "Support OPTEE version 2.0"
	depends on OPTEE_CLIENT
	help
	  U-boot can communicate with trust if
	  the config is enable. This function can
	  be use in android bootloader a/b and avb
	  step.

config OPTEE_ALWAYS_USE_SECURITY_PARTITION
	bool "Support use emmc security partition for OPTEE"
	depends on OPTEE_CLIENT
	help
	  U-boot can secure store data to security partition
	  for nand or emmc, do not to store data to rpmb.

config OPTEE_SECURITY_LEVEL
	int "Support select security level for OPTEE"
	depends on OPTEE_CLIENT
	default 0
	help
	  U-boot can select security level for OPTEE.
```
