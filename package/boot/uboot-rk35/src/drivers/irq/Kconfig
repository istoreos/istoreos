## rtd1296_defconfig
```kconfig
CONFIG_TARGET_realtek=y
CONFIG_TARGET_realtek_rtd129x=y
CONFIG_TARGET_MULTI_PROFILE=y
CONFIG_TARGET_DEVICE_realtek_rtd129x_DEVICE_ars2=y
CONFIG_DEVEL=y
CONFIG_TOOLCHAINOPTS=y
CONFIG_BUSYBOX_CUSTOM=y
CONFIG_ARIA2_BITTORRENT=y
CONFIG_ARIA2_NOXML=y
CONFIG_ARIA2_OPENSSL=y
CONFIG_ARIA2_WEBSOCKET=y
CONFIG_BUILD_PATENTED=y
CONFIG_BUSYBOX_CONFIG_FEATURE_COMPRESS_USAGE=y
CONFIG_BUSYBOX_CONFIG_FEATURE_DD_THIRD_STATUS_LINE=y
CONFIG_BUSYBOX_CONFIG_FEATURE_DF_FANCY=y
# CONFIG_BUSYBOX_CONFIG_FEATURE_FIND_MMIN is not set
CONFIG_BUSYBOX_CONFIG_FEATURE_PREFER_IPV4_ADDRESS=y
CONFIG_BUSYBOX_CONFIG_FEATURE_SUID=y
# CONFIG_BUSYBOX_CONFIG_MONOTONIC_SYSCALL is not set
CONFIG_CCACHE=y
CONFIG_CGROUPFS_MOUNT_KERNEL_CGROUPS=y
# CONFIG_DOCKER_NET_MACVLAN is not set
# CONFIG_DOCKER_NET_OVERLAY is not set
# CONFIG_DOCKER_NET_TFTP is not set
# CONFIG_DOCKER_STO_BTRFS is not set
# CONFIG_DOCKER_STO_EXT4 is not set
CONFIG_EXTERNAL_KERNEL_TREE="/home/build/1296/rtd1296-linux-4.9"
CONFIG_GCC_USE_IREMAP=y
CONFIG_GCC_USE_VERSION_7=y
# CONFIG_GCC_USE_VERSION_8 is not set
CONFIG_GCC_VERSION="7.5.0"
CONFIG_GCC_VERSION_7=y
CONFIG_IB=y
CONFIG_IB_STANDALONE=y
CONFIG_IMAGEOPT=y
CONFIG_KERNEL_DEBUG_GPIO=y
# CONFIG_KERNEL_ELF_CORE is not set
# CONFIG_KERNEL_EXT4_FS_SECURITY is not set
# CONFIG_KERNEL_FANOTIFY is not set
# CONFIG_KERNEL_FHANDLE is not set
# CONFIG_KERNEL_MEMCG_KMEM is not set
CONFIG_KERNEL_NF_CONNTRACK=y
CONFIG_KERNEL_PROC_PID_CPUSET=y
# CONFIG_KERNEL_RESOURCE_COUNTERS is not set
CONFIG_KERNEL_RTL_GSO=y
CONFIG_KERNEL_RTL_JUMBO_FRAME=y
CONFIG_KERNEL_RTL_TSO=y
CONFIG_KERNEL_SLABINFO=y
CONFIG_KERNEL_SLUB_DEBUG=y
CONFIG_KERNEL_SLUB_DEBUG_ON=y
CONFIG_KERNEL_VLAN_8021Q=y
CONFIG_LIBCURL_CRYPTO_AUTH=y
CONFIG_LIBCURL_NTLM=y
CONFIG_LIBCURL_OPENSSL=y
CONFIG_LIBCURL_SMB=y
CONFIG_LIBCURL_SSH2=y
CONFIG_LIBCURL_TFTP=y
CONFIG_LIBCURL_UNIX_SOCKETS=y
# CONFIG_LIBCURL_WOLFSSL is not set
CONFIG_LIBCURL_ZLIB=y
CONFIG_LIBCURL_ZSTD=y
CONFIG_LIBSODIUM_MINIMAL=y
CONFIG_LIBSSH2_OPENSSL=y
# CONFIG_LUCI_CSSTIDY is not set
# CONFIG_LUCI_JSMIN is not set
CONFIG_MUSL_DISABLE_CRYPT_SIZE_HACK=y
CONFIG_NFS_KERNEL_SERVER_V4=y
CONFIG_OPENCONNECT_GNUTLS=y
CONFIG_OPENSSL_OPTIMIZE_SPEED=y
CONFIG_OPENSSL_PREFER_CHACHA_OVER_GCM=y
CONFIG_OPENSSL_WITH_CAMELLIA=y
CONFIG_OPENSSL_WITH_RFC3779=y
CONFIG_OPENSSL_WITH_SEED=y
CONFIG_PACKAGE_TAR_BZIP2=y
CONFIG_PACKAGE_TAR_GZIP=y
CONFIG_PACKAGE_TAR_XZ=y
CONFIG_PACKAGE_TAR_ZSTD=y
CONFIG_PACKAGE_adblock=m
CONFIG_PACKAGE_app-meta-ddnsto=y
CONFIG_PACKAGE_app-meta-linkease=y
CONFIG_PACKAGE_appfilter=y
CONFIG_PACKAGE_aria2=y
CONFIG_PACKAGE_avahi-utils=y
CONFIG_PACKAGE_badblocks=y
CONFIG_PACKAGE_bash=y
CONFIG_PACKAGE_bind-client=y
CONFIG_PACKAGE_bind-libs=y
CONFIG_PACKAGE_boost=m
CONFIG_PACKAGE_boost-chrono=m
CONFIG_PACKAGE_boost-program_options=m
CONFIG_PACKAGE_boost-random=m
CONFIG_PACKAGE_boost-system=m
CONFIG_PACKAGE_bzip2=y
CONFIG_PACKAGE_chinadns-ng=m
CONFIG_PACKAGE_coreutils=y
CONFIG_PACKAGE_coreutils-base64=y
CONFIG_PACKAGE_coreutils-nohup=y
CONFIG_PACKAGE_coreutils-sort=y
CONFIG_PACKAGE_coreutils-stat=y
CONFIG_PACKAGE_ddns-scripts=y
CONFIG_PACKAGE_ddns-scripts-cloudflare=y
CONFIG_PACKAGE_ddns-scripts-cnkuai=y
CONFIG_PACKAGE_ddns-scripts-digitalocean=y
CONFIG_PACKAGE_ddns-scripts-freedns=y
CONFIG_PACKAGE_ddns-scripts-gandi=y
CONFIG_PACKAGE_ddns-scripts-godaddy=y
CONFIG_PACKAGE_ddns-scripts-noip=y
CONFIG_PACKAGE_ddns-scripts-nsupdate=y
CONFIG_PACKAGE_ddns-scripts-route53=y
CONFIG_PACKAGE_ddns-scripts-services=y
CONFIG_PACKAGE_ddns-scripts_aliyun=y
CONFIG_PACKAGE_ddns-scripts_dnspod=y
CONFIG_PACKAGE_ddnsto=y
CONFIG_PACKAGE_dns2socks=m
# CONFIG_PACKAGE_dnsmasq is not set
CONFIG_PACKAGE_etherwake=y
CONFIG_PACKAGE_exfat-fsck=m
CONFIG_PACKAGE_exfat-mkfs=m
CONFIG_PACKAGE_frpc=m
CONFIG_PACKAGE_frps=m
CONFIG_PACKAGE_giflib-utils=y
CONFIG_PACKAGE_haproxy=y
CONFIG_PACKAGE_icu=y
CONFIG_PACKAGE_ip-full=y
CONFIG_PACKAGE_ip6tables-extra=y
CONFIG_PACKAGE_ip6tables-mod-nat=y
CONFIG_PACKAGE_iperf3=y
CONFIG_PACKAGE_iptables-mod-condition=m
CONFIG_PACKAGE_iptables-mod-filter=y
CONFIG_PACKAGE_iptables-mod-iface=y
CONFIG_PACKAGE_iptables-mod-ipmark=y
CONFIG_PACKAGE_iptables-mod-ipsec=y
CONFIG_PACKAGE_iptables-mod-led=m
CONFIG_PACKAGE_iptables-mod-length2=y
CONFIG_PACKAGE_iptables-mod-nat-extra=y
CONFIG_PACKAGE_iptables-mod-nflog=m
CONFIG_PACKAGE_iptables-mod-physdev=y
CONFIG_PACKAGE_iptables-mod-quota2=m
CONFIG_PACKAGE_iptables-mod-sysrq=m
CONFIG_PACKAGE_iptables-mod-trace=m
CONFIG_PACKAGE_kmod-aoe=m
CONFIG_PACKAGE_kmod-block2mtd=m
CONFIG_PACKAGE_kmod-bonding=y
CONFIG_PACKAGE_kmod-chaoskey=m
CONFIG_PACKAGE_kmod-crypto-cts=y
CONFIG_PACKAGE_kmod-crypto-kpp=y
CONFIG_PACKAGE_kmod-crypto-lib-blake2s=y
CONFIG_PACKAGE_kmod-crypto-lib-chacha20=y
CONFIG_PACKAGE_kmod-crypto-lib-chacha20poly1305=y
CONFIG_PACKAGE_kmod-crypto-lib-curve25519=y
CONFIG_PACKAGE_kmod-crypto-lib-poly1305=y
CONFIG_PACKAGE_kmod-crypto-user=y
CONFIG_PACKAGE_kmod-crypto-wq=y
CONFIG_PACKAGE_kmod-crypto-xts=y
CONFIG_PACKAGE_kmod-cryptodev=y
CONFIG_PACKAGE_kmod-dnsresolver=y
CONFIG_PACKAGE_kmod-fs-configfs=y
CONFIG_PACKAGE_kmod-fs-exfat=y
CONFIG_PACKAGE_kmod-fs-exportfs=y
CONFIG_PACKAGE_kmod-fs-ext4=y
CONFIG_PACKAGE_kmod-fs-hfs=y
CONFIG_PACKAGE_kmod-fs-hfsplus=y
CONFIG_PACKAGE_kmod-fs-isofs=y
CONFIG_PACKAGE_kmod-fs-msdos=y
CONFIG_PACKAGE_kmod-fs-nfs=y
CONFIG_PACKAGE_kmod-fs-nfs-common=y
CONFIG_PACKAGE_kmod-fs-nfs-common-rpcsec=y
CONFIG_PACKAGE_kmod-fs-nfs-v3=y
CONFIG_PACKAGE_kmod-fs-nfs-v4=y
CONFIG_PACKAGE_kmod-fs-nfsd=y
CONFIG_PACKAGE_kmod-fs-squashfs=y
CONFIG_PACKAGE_kmod-fs-vfat=y
CONFIG_PACKAGE_kmod-gre=y
CONFIG_PACKAGE_kmod-inet-diag=y
CONFIG_PACKAGE_kmod-input-evdev=y
CONFIG_PACKAGE_kmod-ip6-tunnel=y
CONFIG_PACKAGE_kmod-ip6tables-extra=y
CONFIG_PACKAGE_kmod-ipsec4=y
CONFIG_PACKAGE_kmod-ipsec6=y
CONFIG_PACKAGE_kmod-ipt-compat-xtables=y
CONFIG_PACKAGE_kmod-ipt-condition=m
CONFIG_PACKAGE_kmod-ipt-conntrack-label=m
CONFIG_PACKAGE_kmod-ipt-debug=m
CONFIG_PACKAGE_kmod-ipt-filter=y
CONFIG_PACKAGE_kmod-ipt-fuzzy=m
CONFIG_PACKAGE_kmod-ipt-geoip=m
CONFIG_PACKAGE_kmod-ipt-hashlimit=m
CONFIG_PACKAGE_kmod-ipt-iface=y
CONFIG_PACKAGE_kmod-ipt-ipmark=y
CONFIG_PACKAGE_kmod-ipt-ipp2p=m
CONFIG_PACKAGE_kmod-ipt-ipsec=y
CONFIG_PACKAGE_kmod-ipt-led=m
CONFIG_PACKAGE_kmod-ipt-length2=y
CONFIG_PACKAGE_kmod-ipt-logmark=m
CONFIG_PACKAGE_kmod-ipt-lscan=m
CONFIG_PACKAGE_kmod-ipt-nat-extra=y
CONFIG_PACKAGE_kmod-ipt-nat6=y
CONFIG_PACKAGE_kmod-ipt-nathelper-rtsp=y
CONFIG_PACKAGE_kmod-ipt-nflog=m
CONFIG_PACKAGE_kmod-ipt-nfqueue=m
# CONFIG_PACKAGE_kmod-ipt-offload is not set
CONFIG_PACKAGE_kmod-ipt-physdev=y
CONFIG_PACKAGE_kmod-ipt-quota2=m
CONFIG_PACKAGE_kmod-ipt-raw6=m
CONFIG_PACKAGE_kmod-ipt-rpfilter=m
CONFIG_PACKAGE_kmod-ipt-rtpengine=m
CONFIG_PACKAGE_kmod-ipt-sysrq=m
CONFIG_PACKAGE_kmod-ipt-tarpit=m
CONFIG_PACKAGE_kmod-ipt-tee=m
CONFIG_PACKAGE_kmod-ipt-u32=m
CONFIG_PACKAGE_kmod-ipt-ulog=m
CONFIG_PACKAGE_kmod-iptunnel4=y
CONFIG_PACKAGE_kmod-iptunnel6=y
CONFIG_PACKAGE_kmod-l2tp=y
CONFIG_PACKAGE_kmod-l2tp-eth=y
CONFIG_PACKAGE_kmod-l2tp-ip=y
CONFIG_PACKAGE_kmod-leds-uleds=y
CONFIG_PACKAGE_kmod-ledtrig-activity=y
CONFIG_PACKAGE_kmod-ledtrig-gpio=y
CONFIG_PACKAGE_kmod-ledtrig-oneshot=y
CONFIG_PACKAGE_kmod-ledtrig-pattern=y
CONFIG_PACKAGE_kmod-ledtrig-transient=y
CONFIG_PACKAGE_kmod-lib-crc16=y
CONFIG_PACKAGE_kmod-libphy=y
CONFIG_PACKAGE_kmod-loop=y
CONFIG_PACKAGE_kmod-md-linear=y
CONFIG_PACKAGE_kmod-md-mod=y
CONFIG_PACKAGE_kmod-md-multipath=y
CONFIG_PACKAGE_kmod-md-raid0=y
CONFIG_PACKAGE_kmod-md-raid1=y
CONFIG_PACKAGE_kmod-md-raid10=y
CONFIG_PACKAGE_kmod-md-raid456=y
CONFIG_PACKAGE_kmod-mii=y
CONFIG_PACKAGE_kmod-mmc=y
CONFIG_PACKAGE_kmod-nat46=y
CONFIG_PACKAGE_kmod-nbd=m
CONFIG_PACKAGE_kmod-netatop=m
CONFIG_PACKAGE_kmod-netem=m
CONFIG_PACKAGE_kmod-netlink-diag=y
# CONFIG_PACKAGE_kmod-nf-flow is not set
CONFIG_PACKAGE_kmod-nf-ipvs-ftp=y
CONFIG_PACKAGE_kmod-nf-ipvs-sip=m
CONFIG_PACKAGE_kmod-nf-nat6=y
CONFIG_PACKAGE_kmod-nfnetlink-log=m
CONFIG_PACKAGE_kmod-nfnetlink-queue=m
CONFIG_PACKAGE_kmod-nls-cp437=y
CONFIG_PACKAGE_kmod-nls-cp932=y
CONFIG_PACKAGE_kmod-nls-cp936=y
CONFIG_PACKAGE_kmod-nls-cp950=y
CONFIG_PACKAGE_kmod-nls-iso8859-1=y
CONFIG_PACKAGE_kmod-oaf=y
CONFIG_PACKAGE_kmod-openmax=y
CONFIG_PACKAGE_kmod-pppol2tp=y
CONFIG_PACKAGE_kmod-pptp=y
CONFIG_PACKAGE_kmod-random-core=m
CONFIG_PACKAGE_kmod-rtd1295hwnat=y
CONFIG_PACKAGE_kmod-rtk-emmc=y
# CONFIG_PACKAGE_kmod-rtl8169soc is not set
CONFIG_PACKAGE_kmod-sched=y
CONFIG_PACKAGE_kmod-sched-bpf=y
CONFIG_PACKAGE_kmod-sched-connmark=y
CONFIG_PACKAGE_kmod-sched-ctinfo=y
CONFIG_PACKAGE_kmod-sched-flower=y
CONFIG_PACKAGE_kmod-sched-ipset=y
CONFIG_PACKAGE_kmod-sched-mqprio=y
CONFIG_PACKAGE_kmod-scsi-cdrom=y
CONFIG_PACKAGE_kmod-scsi-generic=y
CONFIG_PACKAGE_kmod-scsi-tape=m
CONFIG_PACKAGE_kmod-sctp=y
CONFIG_PACKAGE_kmod-sdhci=y
CONFIG_PACKAGE_kmod-sit=y
CONFIG_PACKAGE_kmod-tcp-bbr=m
CONFIG_PACKAGE_kmod-usb-dwc2=y
CONFIG_PACKAGE_kmod-usb-dwc3=y
CONFIG_PACKAGE_kmod-usb-ehci=y
CONFIG_PACKAGE_kmod-usb-ledtrig-usbport=y
CONFIG_PACKAGE_kmod-usb-net=y
CONFIG_PACKAGE_kmod-usb-net-asix=y
CONFIG_PACKAGE_kmod-usb-net-asix-ax88179=y
CONFIG_PACKAGE_kmod-usb-net-cdc-eem=y
CONFIG_PACKAGE_kmod-usb-net-cdc-ether=y
CONFIG_PACKAGE_kmod-usb-net-cdc-mbim=y
CONFIG_PACKAGE_kmod-usb-net-cdc-ncm=y
CONFIG_PACKAGE_kmod-usb-net-cdc-subset=y
CONFIG_PACKAGE_kmod-usb-net-dm9601-ether=y
CONFIG_PACKAGE_kmod-usb-net-hso=y
CONFIG_PACKAGE_kmod-usb-net-huawei-cdc-ncm=y
CONFIG_PACKAGE_kmod-usb-net-ipheth=y
CONFIG_PACKAGE_kmod-usb-net-kalmia=y
CONFIG_PACKAGE_kmod-usb-net-kaweth=y
CONFIG_PACKAGE_kmod-usb-net-mcs7830=y
CONFIG_PACKAGE_kmod-usb-net-pegasus=y
CONFIG_PACKAGE_kmod-usb-net-pl=y
CONFIG_PACKAGE_kmod-usb-net-qmi-wwan=y
CONFIG_PACKAGE_kmod-usb-net-rndis=y
CONFIG_PACKAGE_kmod-usb-net-rtl8150=y
CONFIG_PACKAGE_kmod-usb-net-sierrawireless=y
CONFIG_PACKAGE_kmod-usb-net-smsc95xx=y
CONFIG_PACKAGE_kmod-usb-net-sr9700=y
CONFIG_PACKAGE_kmod-usb-ohci=y
CONFIG_PACKAGE_kmod-usb-printer=y
CONFIG_PACKAGE_kmod-usb-serial=y
CONFIG_PACKAGE_kmod-usb-serial-ch341=y
CONFIG_PACKAGE_kmod-usb-serial-cp210x=y
CONFIG_PACKAGE_kmod-usb-serial-garmin=y
CONFIG_PACKAGE_kmod-usb-serial-pl2303=y
CONFIG_PACKAGE_kmod-usb-storage-extras=y
CONFIG_PACKAGE_kmod-usb-uhci=y
CONFIG_PACKAGE_kmod-usb-wdm=y
CONFIG_PACKAGE_kmod-usb2=y
CONFIG_PACKAGE_kmod-usb3=y
CONFIG_PACKAGE_kmod-usbip=m
CONFIG_PACKAGE_kmod-usbip-client=m
CONFIG_PACKAGE_kmod-usbip-server=m
CONFIG_PACKAGE_kmod-usbmon=m
CONFIG_PACKAGE_kmod-wireguard=y
CONFIG_PACKAGE_libbz2=y
CONFIG_PACKAGE_libcap-ng=y
CONFIG_PACKAGE_libcares=y
CONFIG_PACKAGE_libev=y
CONFIG_PACKAGE_libevent2=y
CONFIG_PACKAGE_libexif=y
CONFIG_PACKAGE_libgdbm=y
CONFIG_PACKAGE_libintl-full=y
CONFIG_PACKAGE_libiwinfo=y
CONFIG_PACKAGE_libiwinfo-data=y
CONFIG_PACKAGE_libiwinfo-lua=y
CONFIG_PACKAGE_libjpeg-turbo=y
CONFIG_PACKAGE_libkeyutils=y
CONFIG_PACKAGE_libltdl=y
CONFIG_PACKAGE_liblua5.3=y
CONFIG_PACKAGE_liblzma=y
CONFIG_PACKAGE_libmbedtls=m
CONFIG_PACKAGE_libminiupnpc=y
CONFIG_PACKAGE_libnatpmp=y
CONFIG_PACKAGE_libnftnl=y
CONFIG_PACKAGE_libnl-core=y
CONFIG_PACKAGE_libnl-genl=y
CONFIG_PACKAGE_libpcre=y
CONFIG_PACKAGE_libsodium=y
CONFIG_PACKAGE_libsqlite3=y
CONFIG_PACKAGE_libssh2=y
CONFIG_PACKAGE_libstdcpp=y
CONFIG_PACKAGE_libuci-lua=y
CONFIG_PACKAGE_libudns=m
# CONFIG_PACKAGE_libwolfssl is not set
CONFIG_PACKAGE_libwrap=y
CONFIG_PACKAGE_libxml2=y
CONFIG_PACKAGE_libxtables-nft=y
CONFIG_PACKAGE_libzstd=y
CONFIG_PACKAGE_linkease=y
CONFIG_PACKAGE_luabitop=y
CONFIG_PACKAGE_luci=y
CONFIG_PACKAGE_luci-app-adblock=m
CONFIG_PACKAGE_luci-app-argon-config=y
CONFIG_PACKAGE_luci-app-aria2=y
CONFIG_PACKAGE_luci-app-autotimeset=m
CONFIG_PACKAGE_luci-app-baidupcs-web=m
CONFIG_PACKAGE_luci-app-control-timewol=y
CONFIG_PACKAGE_luci-app-control-webrestriction=y
CONFIG_PACKAGE_luci-app-control-weburl=y
CONFIG_PACKAGE_luci-app-ddns=y
CONFIG_PACKAGE_luci-app-ddnsto=y
CONFIG_PACKAGE_luci-app-fileassistant=y
CONFIG_PACKAGE_luci-app-firewall=y
CONFIG_PACKAGE_luci-app-frpc=m
CONFIG_PACKAGE_luci-app-frps=m
CONFIG_PACKAGE_luci-app-ledtrig-usbport=y
CONFIG_PACKAGE_luci-app-linkease=y
CONFIG_PACKAGE_luci-app-nfs=y
CONFIG_PACKAGE_luci-app-oaf=y
CONFIG_PACKAGE_luci-app-opkg=y
CONFIG_PACKAGE_luci-app-ota=y
CONFIG_PACKAGE_luci-app-passwall=m
# CONFIG_PACKAGE_luci-app-passwall_INCLUDE_Shadowsocks_Libev_Client is not set
# CONFIG_PACKAGE_luci-app-passwall_INCLUDE_Shadowsocks_Libev_Server is not set
# CONFIG_PACKAGE_luci-app-passwall_INCLUDE_Simple_Obfs is not set
# CONFIG_PACKAGE_luci-app-passwall_INCLUDE_V2ray_Plugin is not set
CONFIG_PACKAGE_luci-app-quickstart=y
CONFIG_PACKAGE_luci-app-smartdns=m
CONFIG_PACKAGE_luci-app-store=y
CONFIG_PACKAGE_luci-app-timecontrol=y
CONFIG_PACKAGE_luci-app-tn-netports=y
CONFIG_PACKAGE_luci-app-upnp=y
CONFIG_PACKAGE_luci-app-vlmcsd=y
CONFIG_PACKAGE_luci-app-wireguard=m
CONFIG_PACKAGE_luci-app-wol=y
CONFIG_PACKAGE_luci-i18n-adblock-zh-cn=m
CONFIG_PACKAGE_luci-i18n-argon-config-zh-cn=y
CONFIG_PACKAGE_luci-i18n-aria2-zh-cn=y
CONFIG_PACKAGE_luci-i18n-autotimeset-zh-cn=m
CONFIG_PACKAGE_luci-i18n-control-timewol-zh-cn=y
CONFIG_PACKAGE_luci-i18n-control-webrestriction-zh-cn=y
CONFIG_PACKAGE_luci-i18n-control-weburl-zh-cn=y
CONFIG_PACKAGE_luci-i18n-ddns-zh-cn=y
CONFIG_PACKAGE_luci-i18n-ddnsto-zh-cn=y
CONFIG_PACKAGE_luci-i18n-firewall-zh-cn=y
CONFIG_PACKAGE_luci-i18n-frpc-zh-cn=m
CONFIG_PACKAGE_luci-i18n-frps-zh-cn=m
CONFIG_PACKAGE_luci-i18n-linkease-zh-cn=y
CONFIG_PACKAGE_luci-i18n-nfs-zh-cn=y
CONFIG_PACKAGE_luci-i18n-oaf-zh-cn=y
CONFIG_PACKAGE_luci-i18n-opkg-zh-cn=y
CONFIG_PACKAGE_luci-i18n-ota-zh-cn=y
CONFIG_PACKAGE_luci-i18n-passwall-zh-cn=m
CONFIG_PACKAGE_luci-i18n-quickstart-zh-cn=y
CONFIG_PACKAGE_luci-i18n-smartdns-zh-cn=m
CONFIG_PACKAGE_luci-i18n-timecontrol-zh-cn=y
CONFIG_PACKAGE_luci-i18n-tn-netports-zh-cn=y
CONFIG_PACKAGE_luci-i18n-upnp-zh-cn=y
CONFIG_PACKAGE_luci-i18n-vlmcsd-zh-cn=y
CONFIG_PACKAGE_luci-i18n-wireguard-zh-cn=m
CONFIG_PACKAGE_luci-i18n-wol-zh-cn=y
CONFIG_PACKAGE_luci-lib-httpclient=y
CONFIG_PACKAGE_luci-lib-httpprotoutils=y
CONFIG_PACKAGE_luci-lib-iptparser=y
CONFIG_PACKAGE_luci-lib-jquery-1-4=y
CONFIG_PACKAGE_luci-lib-json=y
CONFIG_PACKAGE_luci-lib-mac-vendor=y
CONFIG_PACKAGE_luci-mod-admin-full=y
CONFIG_PACKAGE_luci-mod-network=y
CONFIG_PACKAGE_luci-mod-rpc=y
CONFIG_PACKAGE_luci-mod-status=y
CONFIG_PACKAGE_luci-mod-system=y
CONFIG_PACKAGE_luci-proto-bonding=y
CONFIG_PACKAGE_luci-proto-hnet=y
CONFIG_PACKAGE_luci-proto-ipv6=y
CONFIG_PACKAGE_luci-proto-openconnect=y
CONFIG_PACKAGE_luci-proto-openfortivpn=y
CONFIG_PACKAGE_luci-proto-ppp=y
CONFIG_PACKAGE_luci-proto-pppossh=y
CONFIG_PACKAGE_luci-proto-relay=y
CONFIG_PACKAGE_luci-proto-sstp=y
CONFIG_PACKAGE_luci-proto-vpnc=y
CONFIG_PACKAGE_luci-proto-vxlan=y
CONFIG_PACKAGE_luci-proto-wireguard=y
CONFIG_PACKAGE_luci-theme-argon=y
CONFIG_PACKAGE_luci-theme-bootstrap=y
CONFIG_PACKAGE_luci-theme-openwrt-2020=y
CONFIG_PACKAGE_mdadm=y
CONFIG_PACKAGE_microsocks=m
CONFIG_PACKAGE_miniupnpd=y
CONFIG_PACKAGE_nfs-kernel-server=y
CONFIG_PACKAGE_nfs-kernel-server-utils=y
CONFIG_PACKAGE_nfs-utils=y
CONFIG_PACKAGE_nfs-utils-libs=y
CONFIG_PACKAGE_openconnect=y
CONFIG_PACKAGE_openfortivpn=y
CONFIG_PACKAGE_openmax=y
CONFIG_PACKAGE_p910nd=m
CONFIG_PACKAGE_pdnsd-alt=m
CONFIG_PACKAGE_ppp-mod-pppol2tp=y
CONFIG_PACKAGE_ppp-mod-pptp=y
CONFIG_PACKAGE_pppossh=y
CONFIG_PACKAGE_proto-bonding=y
CONFIG_PACKAGE_quickstart=y
CONFIG_PACKAGE_relayd=y
CONFIG_PACKAGE_resolveip=y
CONFIG_PACKAGE_rpcbind=y
CONFIG_PACKAGE_rpcd-mod-iwinfo=y
CONFIG_PACKAGE_rpcd-mod-rrdns=y
CONFIG_PACKAGE_rtk-supplicant=y
CONFIG_PACKAGE_shadow=y
CONFIG_PACKAGE_shadow-chage=y
CONFIG_PACKAGE_shadow-chfn=y
CONFIG_PACKAGE_shadow-chgpasswd=y
CONFIG_PACKAGE_shadow-chpasswd=y
CONFIG_PACKAGE_shadow-chsh=y
CONFIG_PACKAGE_shadow-common=y
CONFIG_PACKAGE_shadow-expiry=y
CONFIG_PACKAGE_shadow-faillog=y
CONFIG_PACKAGE_shadow-gpasswd=y
CONFIG_PACKAGE_shadow-groupadd=y
CONFIG_PACKAGE_shadow-groupdel=y
CONFIG_PACKAGE_shadow-groupmems=y
CONFIG_PACKAGE_shadow-groupmod=y
CONFIG_PACKAGE_shadow-groups=y
CONFIG_PACKAGE_shadow-grpck=y
CONFIG_PACKAGE_shadow-grpconv=y
CONFIG_PACKAGE_shadow-grpunconv=y
CONFIG_PACKAGE_shadow-lastlog=y
CONFIG_PACKAGE_shadow-login=y
CONFIG_PACKAGE_shadow-logoutd=y
CONFIG_PACKAGE_shadow-newgidmap=y
CONFIG_PACKAGE_shadow-newgrp=y
CONFIG_PACKAGE_shadow-newuidmap=y
CONFIG_PACKAGE_shadow-newusers=y
CONFIG_PACKAGE_shadow-nologin=y
CONFIG_PACKAGE_shadow-passwd=y
CONFIG_PACKAGE_shadow-pwck=y
CONFIG_PACKAGE_shadow-pwconv=y
CONFIG_PACKAGE_shadow-pwunconv=y
CONFIG_PACKAGE_shadow-su=y
CONFIG_PACKAGE_shadow-useradd=y
CONFIG_PACKAGE_shadow-userdel=y
CONFIG_PACKAGE_shadow-usermod=y
CONFIG_PACKAGE_shadow-utils=y
CONFIG_PACKAGE_shadow-vipw=y
CONFIG_PACKAGE_shadowsocks-libev-config=m
CONFIG_PACKAGE_shadowsocks-libev-ss-local=m
CONFIG_PACKAGE_shadowsocks-libev-ss-redir=m
CONFIG_PACKAGE_shadowsocks-libev-ss-server=m
CONFIG_PACKAGE_shadowsocks-rust-sslocal=m
CONFIG_PACKAGE_shadowsocksr-libev-ssr-local=m
CONFIG_PACKAGE_shadowsocksr-libev-ssr-redir=m
CONFIG_PACKAGE_smartdns=m
CONFIG_PACKAGE_sstp-client=y
CONFIG_PACKAGE_tar=y
CONFIG_PACKAGE_tcping=m
CONFIG_PACKAGE_transmission-daemon=m
CONFIG_PACKAGE_trojan-plus=m
CONFIG_PACKAGE_uhttpd=y
CONFIG_PACKAGE_uhttpd-mod-ubus=y
CONFIG_PACKAGE_unzip=y
CONFIG_PACKAGE_v2ray-core=m
CONFIG_PACKAGE_vlmcsd=y
CONFIG_PACKAGE_vpnc=y
CONFIG_PACKAGE_vpnc-scripts=y
CONFIG_PACKAGE_vxlan=y
CONFIG_PACKAGE_wget-ssl=y
CONFIG_PACKAGE_wireguard-tools=y
CONFIG_PACKAGE_xl2tpd=y
CONFIG_PACKAGE_xray-core=m
CONFIG_PACKAGE_xz=y
CONFIG_PACKAGE_xz-utils=y
CONFIG_PROCD_SHOW_BOOT=y
CONFIG_RPCBIND_LIBWRAP=y
CONFIG_RPCBIND_RMTCALLS=y
CONFIG_SDK=y
CONFIG_SQLITE3_DYNAMIC_EXTENSIONS=y
CONFIG_SQLITE3_FTS3=y
CONFIG_SQLITE3_FTS4=y
CONFIG_SQLITE3_FTS5=y
CONFIG_SQLITE3_JSON1=y
CONFIG_SQLITE3_RTREE=y
# CONFIG_TARGET_ROOTFS_EXT4FS is not set
CONFIG_VERSIONOPT=y
CONFIG_VERSION_BUG_URL=""
CONFIG_VERSION_CODE=""
CONFIG_VERSION_CODE_FILENAMES=y
CONFIG_VERSION_DIST="OpenWrt"
CONFIG_VERSION_FILENAMES=y
CONFIG_VERSION_HOME_URL=""
CONFIG_VERSION_HWREV=""
CONFIG_VERSION_MANUFACTURER=""
CONFIG_VERSION_MANUFACTURER_URL=""
CONFIG_VERSION_NUMBER="21.02.2"
CONFIG_VERSION_PRODUCT=""
CONFIG_VERSION_REPO="https://downloads.openwrt.org/releases/21.02.2"
CONFIG_VERSION_SUPPORT_URL=""
CONFIG_VPNC_GNUTLS=y
CONFIG_ZLIB_OPTIMIZE_SPEED=y
CONFIG_ZSTD_OPTIMIZE_O3=y
CONFIG_boost-compile-visibility-hidden=y
CONFIG_boost-runtime-shared=y
CONFIG_boost-static-and-shared-libs=y
CONFIG_boost-variant-release=y
CONFIG_shadow-all=y
CONFIG_KERNEL_BTRFS_FS_POSIX_ACL=y
CONFIG_KERNEL_EXT4_FS_POSIX_ACL=y
CONFIG_KERNEL_FS_POSIX_ACL=y
CONFIG_PACKAGE_kmod-crypto-deflate=y
CONFIG_PACKAGE_kmod-crypto-echainiv=y
CONFIG_PACKAGE_kmod-crypto-gcm=y
CONFIG_PACKAGE_kmod-crypto-ghash=y
CONFIG_PACKAGE_kmod-dummy=y
# CONFIG_PACKAGE_kmod-ip-vti is not set
# CONFIG_PACKAGE_kmod-ip6-vti is not set
CONFIG_PACKAGE_kmod-ipsec=y
CONFIG_PACKAGE_kmod-ipsec4=y
CONFIG_PACKAGE_kmod-ipsec6=y
# CONFIG_PACKAGE_kmod-xfrm-interface is not set
# CONFIG_PACKAGE_xfrm is not set
```
