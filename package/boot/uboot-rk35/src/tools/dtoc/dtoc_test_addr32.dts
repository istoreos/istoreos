/*
 * Test device tree file for dtoc
 *
 * Copyright 2017 Google, Inc
 *
 * SPDX-License-Identifier:	GPL-2.0+
 */

 /dts-v1/;

/ {
	#address-cells = <1>;
	#size-cells = <1>;

	test1 {
		u-boot,dm-pre-reloc;
		compatible = "test1";
		reg = <0x1234 0x5678>;
	};

	test2 {
		u-boot,dm-pre-reloc;
		compatible = "test2";
		reg = <0x12345678 0x98765432 2 3>;
	};

};
