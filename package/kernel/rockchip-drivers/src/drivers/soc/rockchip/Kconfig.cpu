## package/kernel/rockchip-drivers/src/drivers/soc/rockchip/Kconfig.cpu
```kconfig
# SPDX-License-Identifier: GPL-2.0

menu "Rockchip CPU selection"
	depends on ARCH_ROCKCHIP

config CPU_RK312X
	bool "RK3126/8"
	depends on ARM

config CPU_RK3036
	bool "RK3036"
	depends on ARM

config CPU_RK30XX
	bool "RK3066/8"
	depends on ARM

config CPU_RK3188
	bool "RK3188"
	depends on ARM

config CPU_RK3288
	bool "RK3288"
	depends on ARM

config CPU_RK322X
	bool "RK3228/9"
	depends on ARM

config CPU_RV1103B
	bool "RV1103B"
	depends on ARM

config CPU_RV1106
	bool "RV1103/6"
	depends on ARM

config CPU_RV1108
	bool "RV1107/8"
	depends on ARM

config CPU_RV1126
	bool "RV1109/26"
	depends on ARM

config CPU_RV1126B
	bool "RV1126B"
	depends on ARM || ARM64

config CPU_PX30
	bool "PX30"
	depends on ARM || ARM64

config CPU_RK1808
	bool "RK1808"
	depends on ARM || ARM64

config CPU_RK3308
	bool "RK3308"
	depends on ARM || ARM64

config CPU_RK3328
	bool "RK3328"
	depends on ARM || ARM64

config CPU_RK3368
	bool "RK3368"
	depends on ARM || ARM64

config CPU_RK3399
	bool "RK3399"
	depends on ARM || ARM64

config CPU_RK3506
	bool "RK3506"
	depends on ARM || ARM64

config CPU_RK3528
	bool "RK3528"
	depends on ARM || ARM64

config CPU_RK3538
	bool "RK3538"
	depends on ARM || ARM64

config CPU_RK3562
	bool "RK3562"
	depends on ARM || ARM64

config CPU_RK3568
	bool "RK3566/8"
	depends on ARM || ARM64

config CPU_RK3572
	bool "RK3572"
	depends on ARM || ARM64

config CPU_RK3576
	bool "RK3576"
	depends on ARM || ARM64

config CPU_RK3588
	bool "RK3588"
	depends on ARM || ARM64

endmenu
```

## target/linux/rockchip/rk35xx/files/drivers/media/platform/rockchip/Kconfig
```kconfig
# SPDX-License-Identifier: GPL-2.0

source "drivers/media/platform/rockchip/hdmirx/Kconfig"
```
